/**
 ******************************************************************************
 * @file    menu.c
 * @brief   Marlin 风格菜单引擎：菜单栈、滚动窗口、反白高亮、提示
 *
 *  这里是**纯引擎**，只管导航/显示/按键。
 *  菜单树（有什么项、每项干什么）在 menu_tree.c 中定义。
 *
 *  显示布局（128x64，每屏 3 行 16 像素）
 *      ┌────────────────────────────┐
 *      │ 标题（整条反白）      1/8  │  16 px
 *      ├────────────────────────────┤
 *      │ ▓选中项（整行反白）     ▸  │  16 px
 *      │   其它项                    │  16 px
 *      │   其它项                    │  16 px
 *      └────────────────────────────┘
 ******************************************************************************
 */

/* Includes ------------------------------------------------------------------*/
#include "main.h"
#include "menu.h"
#include "button.h"
#include "oled.h"
#include "ir_sensor.h"

#include <stdio.h>

/* ============================== 引擎参数 =================================== */

/** 每屏显示几项（标题占 16 像素，剩下 48 像素正好 3 行 16x16 汉字） */
#define 菜单_可见行数       3U
/** 最多能进几层子菜单 */
#define 菜单_最大深度       4U

/* ---------------------------- 流水屏（跑马灯） ---------------------------- */
/*
 *  菜单项标题太长时（比如"巡线传感器读数"这类），原来就被右边界生生截断，
 *  看不全。现在让**当前选中那一项**滚起来，其它的照旧截断 ——
 *  三条一起滚会看得眼晕，而且选中项才是你要读的那个。
 */
#define 菜单_文字左          2       /* 列表文字的左边距 */
#define 菜单_文字右          116     /* 右边留出 ">" 和页码的位置 */
#define 菜单_滚动间隔毫秒    60U     /* 多久挪一次 */
#define 菜单_滚动步进像素    3       /* 一次挪几像素（60ms / 3px ≈ 50 像素每秒） */

/* ---------------------------- 页面切换动画 -------------------------------- */
/*
 *  进子菜单 / 返回时，旧页和新页做一次水平滑动：
 *      进子菜单：内容整体向左走 —— 旧页滑出左边，新页从右边滑进来
 *      返回    ：内容整体向右走 —— 旧页滑出右边，上一级的新页从左边滑回来
 *  两者是同一个动作的正反过程（返回就是偏移倒着走），方向错了会很像"又进了一层"。
 *
 *  ── 为什么要变速 ──
 *      一帧要刷一次整屏，而整屏 1024 字节走软件 I2C 大约 30 ms，这是硬件给的
 *      上限，改不了（再压 I2C 延时就不满足 SSD1306 的时序了）。
 *      所以帧率固定在 33 帧/秒左右，光靠"每帧挪一样多"会显得一蹦一蹦的。
 *      这里改成两头小、中间大：起步和收尾慢一点，中间冲过去，看起来就顺了。
 *
 *      下面的数字是**每一帧挪多少像素**，加起来正好 128（一整屏）。
 *      12 帧 × 30 ms ≈ 360 ms，和手机上的翻页时长差不多。
 *      嫌慢就删几个数、嫌跳就把数改小再加几项，改这一行就行。
 */
static const uint8_t 菜单_动画步长[] = {
    6, 8, 10, 12, 14, 14, 14, 14, 12, 10, 8, 6
};
#define 菜单_动画帧数   (sizeof(菜单_动画步长) / sizeof(菜单_动画步长[0]))

/* ============================== 引擎状态 =================================== */

static const 菜单项 *菜单_栈[菜单_最大深度];       /* 每一级的菜单表 */
static const char   *菜单_标题栈[菜单_最大深度];   /* 每一级的标题 */
static uint8_t      菜单_深度;                     /* 1 = 在主菜单 */
static uint8_t      菜单_选中;                     /* 当前选中第几项（表内下标） */
static uint8_t      菜单_首项;                     /* 屏幕上第一行是第几项 */

/** 页面切换动画用的两张整屏画面（各 1 KB） */
static uint8_t      动画_旧页[OLED_显存大小];
static uint8_t      动画_新页[OLED_显存大小];

/** 流水屏：当前滚动到哪一像素 */
static int16_t      滚动_相位     = 0;
/** 流水屏：上次挪动的时刻 */
static uint32_t     滚动_上次时刻 = 0U;
/** 流水屏：正在滚的是哪一段文字（换了一项就归零，从开头重新滚） */
static const char   *滚动_当前文本 = NULL;

/* ============================== 引擎内部 =================================== */

/** 数一张菜单表有多少项（遇到 菜单项_结束 就停） */
static uint8_t 菜单_项数(const 菜单项 *表)
{
    uint8_t n = 0U;

    while ((表[n].类型 != 菜单项_结束) && (n < 100U)) {
        n++;
    }
    return n;
}

/** 当前正在显示的菜单表 */
static const 菜单项 *菜单_当前表(void)
{
    return 菜单_栈[菜单_深度 - 1U];
}

/** 跟着选中项调整滚动窗口，保证选中项一定在屏幕上 */
static void 菜单_调整滚动(void)
{
    if (菜单_选中 < 菜单_首项) {
        菜单_首项 = 菜单_选中;
    } else if (菜单_选中 >= (uint8_t)(菜单_首项 + 菜单_可见行数)) {
        菜单_首项 = (uint8_t)(菜单_选中 - 菜单_可见行数 + 1U);
    }
}

/** 简短提示：清屏 + 一行字 + 停顿（动作执行前给个反馈） */
void 菜单_提示(const char *文字, uint16_t 毫秒)
{
    OLED_清屏();
    OLED_显示中文串(0, 24, 文字);
    OLED_刷新();
    HAL_Delay(毫秒);
}

/**
  * @brief  只把当前菜单画进显存，不往屏上送
  * @note   和 菜单_重画() 拆开是为了页面切换动画：动画要先把新页安静地画好，
  *         再一帧一帧地和旧页合成，中间不能自己刷屏。
  */
static void 菜单_绘制(void)
{
    const 菜单项 *表 = 菜单_当前表();
    uint8_t      总数 = 菜单_项数(表);
    char         小字[12];
    uint8_t      行;

    /* 选中项换了就把滚动相位归零，让新的一项从开头开始滚 */
    if (表[菜单_选中].标题 != 滚动_当前文本) {
        滚动_当前文本 = 表[菜单_选中].标题;
        滚动_相位     = 0;
    }

    OLED_清屏();

    /* ---- 标题栏：整条反白，标题用黑字 ---- */
    OLED_填充矩形(0, 0, OLED_宽 - 1, 15, OLED_亮);
    OLED_显示中文串色(2, 0, 菜单_标题栈[菜单_深度 - 1U], OLED_灭);

    /* 右上角 "第几项/共几项"，方便知道还有没有下一页 */
    (void)snprintf(小字, sizeof(小字), "%u/%u",
                   (unsigned)(菜单_选中 + 1U), (unsigned)总数);
    OLED_显示ASCII串色((int16_t)(126 - (int16_t)OLED_文本宽度(小字)), 4,
                       小字, OLED_灭);

    /* ---- 列表：每行 16 像素，选中项整行反白 ---- */
    for (行 = 0U; 行 < 菜单_可见行数; 行++)
    {
        uint8_t 下标 = (uint8_t)(菜单_首项 + 行);
        int16_t 行顶 = (int16_t)(16 + 行 * 16);
        uint8_t 高亮;

        if (下标 >= 总数) {
            break;                              /* 这一页没有更多项了 */
        }

        高亮 = (下标 == 菜单_选中) ? 1U : 0U;

        if (高亮 != 0U) {
            OLED_画矩形(0, 行顶, OLED_宽 - 1, (int16_t)(行顶 + 15), OLED_亮);
        }

        /* 标题太长：只有选中这一项才滚起来，而且用裁剪窗口把它关在本行内，
           不许它压到右边的 ">" 和页码上 */
        if ((高亮 != 0U)
            && (OLED_文本宽度(表[下标].标题) > (菜单_文字右 - 菜单_文字左)))
        {
            OLED_设裁剪(菜单_文字左, 行顶, 菜单_文字右, (int16_t)(行顶 + 15));
            OLED_显示中文串滚动(菜单_文字左, 行顶, 表[下标].标题, 滚动_相位);
            OLED_清裁剪();
        }
        else
        {
            OLED_显示中文串色(菜单_文字左, 行顶, 表[下标].标题, OLED_亮);
        }

        /* 返回项在文字后面画 U 形返回箭头 */
        if (表[下标].类型 == 菜单项_返回)
        {
            int16_t ax = 36;
            int16_t ay = (int16_t)(行顶 + 2);

            OLED_画线((int16_t)(ax + 2), ay,
                      (int16_t)(ax + 5), ay, OLED_亮);
            OLED_画线((int16_t)(ax + 7), ay,
                      (int16_t)(ax + 12), ay, OLED_亮);

            OLED_画线((int16_t)(ax + 12), ay,
                      (int16_t)(ax + 12), (int16_t)(ay + 10), OLED_亮);

            OLED_画线((int16_t)(ax + 12), (int16_t)(ay + 10),
                      (int16_t)(ax + 3), (int16_t)(ay + 10), OLED_亮);

            OLED_画线((int16_t)(ax + 1), (int16_t)(ay + 10),
                      (int16_t)(ax + 3), (int16_t)(ay + 8), OLED_亮);
            OLED_画线((int16_t)(ax + 1), (int16_t)(ay + 10),
                      (int16_t)(ax + 3), (int16_t)(ay + 12), OLED_亮);
        }

        /* 子菜单在右侧标一个 ">" */
        if (表[下标].类型 == 菜单项_子菜单)
        {
            OLED_显示ASCII串色(120, (int16_t)(行顶 + 4), ">", OLED_亮);
        }
    }
}

/**
  * @brief  重画当前菜单并立即上屏
  */
static void 菜单_重画(void)
{
    菜单_绘制();
    OLED_刷新();
}

/** 1 = 当前选中项的标题太长，需要滚动 */
static uint8_t 菜单_选中项要滚(void)
{
    const 菜单项 *表 = 菜单_当前表();

    /* 防御：空表 / 兜底项也可能被选中，别拿 NULL 标题去算宽度 */
    if ((表[菜单_选中].类型 == 菜单项_结束) || (表[菜单_选中].标题 == NULL)) {
        return 0U;
    }

    return (OLED_文本宽度(表[菜单_选中].标题) > (菜单_文字右 - 菜单_文字左)) ? 1U : 0U;
}

/**
  * @brief  换页动画：把旧页和新页横向滑一下
  * @param  新页从右边进  1 = 进子菜单（往深处走，内容整体左移）
  *                       0 = 返回上一级（内容整体右移）
  * @note   调用前菜单栈/选中/首项必须已经改好，这里只负责画和动。
  */
static void 菜单_切换动画(uint8_t 新页从右边进)
{
    const uint8_t *左图;
    const uint8_t *右图;
    int16_t       偏移;
    uint8_t       帧;

    OLED_取显存(动画_旧页);          /* 切换前的那一屏 */
    菜单_绘制();                     /* 新页安静地画进显存，先不上屏 */
    OLED_取显存(动画_新页);

    /*  OLED_合成滑动(左, 右, d) 的规则是"d 越大，内容越往左走"：
     *      d = 0    -> 整屏是左图
     *      d = 128  -> 整屏是右图
     *  所以：
     *      进子菜单 = 旧页当左图、新页当右图，d 从 0 加到 128（内容左移）
     *      返回     = 新页当左图、旧页当右图，d 从 128 减到 0（内容右移）
     */
    if (新页从右边进 != 0U)
    {
        左图 = 动画_旧页;
        右图 = 动画_新页;

        偏移 = 0;
        for (帧 = 0U; 帧 < 菜单_动画帧数; 帧++)
        {
            偏移 = (int16_t)(偏移 + 菜单_动画步长[帧]);
            if (偏移 > OLED_宽) {
                偏移 = OLED_宽;
            }
            OLED_合成滑动(左图, 右图, 偏移);
            OLED_刷新();
        }
    }
    else
    {
        左图 = 动画_新页;
        右图 = 动画_旧页;

        偏移 = OLED_宽;
        for (帧 = 0U; 帧 < 菜单_动画帧数; 帧++)
        {
            偏移 = (int16_t)(偏移 - 菜单_动画步长[帧]);
            if (偏移 < 0) {
                偏移 = 0;
            }
            OLED_合成滑动(左图, 右图, 偏移);
            OLED_刷新();
        }
    }

    /* 步长表加起来正好 128，所以最后一帧就是完整的新页，不用再补一次刷新 */
    OLED_置显存(动画_新页);
}

/** 处理一个按键事件 */
static void 菜单_处理(btn_event_t 事件)
{
    const 菜单项 *表 = 菜单_当前表();
    uint8_t      总数 = 菜单_项数(表);
    const 菜单项 *项;

    if (总数 == 0U) {
        return;
    }
    项 = &表[菜单_选中];

    switch (事件)
    {
        case BTN_UP:
            菜单_选中 = (菜单_选中 == 0U) ? (uint8_t)(总数 - 1U)
                                          : (uint8_t)(菜单_选中 - 1U);
            菜单_调整滚动();
            菜单_重画();
            break;

        case BTN_DOWN:
            菜单_选中 = (uint8_t)((菜单_选中 + 1U) % 总数);
            菜单_调整滚动();
            菜单_重画();
            break;

        case BTN_SEL:
            switch (项->类型)
            {
                case 菜单项_子菜单:
                    if ((项->子菜单 != 0) && (菜单_深度 < 菜单_最大深度))
                    {
                        菜单_栈[菜单_深度] = 项->子菜单;
                        菜单_标题栈[菜单_深度] = 项->标题;
                        菜单_深度++;
                        菜单_选中 = 0U;
                        菜单_首项 = 0U;
                        菜单_切换动画(1U);          /* 新页从右边滑进来 */
                    }
                    else
                    {
                        菜单_重画();                /* 进不去，原地重画一下 */
                    }
                    break;

                case 菜单项_命令:
                    if (项->动作 != 0) {
                        项->动作();                 /* 跑任务，跑完自己回到菜单 */
                    }
                    菜单_重画();
                    break;

                case 菜单项_返回:
                    if (菜单_深度 > 1U)
                    {
                        菜单_深度--;
                        菜单_选中 = 0U;
                        菜单_首项 = 0U;
                        菜单_切换动画(0U);          /* 新页从左边滑回来 */
                    }
                    else
                    {
                        菜单_重画();
                    }
                    break;

                default:
                    break;
            }
            break;

        /* 长按确定键 = 返回上一级 */
        case BTN_BACK:
            if (菜单_深度 > 1U)
            {
                菜单_深度--;
                菜单_选中 = 0U;
                菜单_首项 = 0U;
                菜单_切换动画(0U);
            }
            break;

        default:
            break;
    }
}

/* ============================== 串口标定 =================================== */

void 菜单_串口标定(void)
{
    char 行[20];

    OLED_初始化();
    printf("\r\n===== 5-way IR raw values (0-4095) =====\r\n");

    for (;;)
    {
        uint8_t i;

        OLED_清屏();
        OLED_显示ASCII串(0, 0, "SERIAL MODE");
        for (i = 0U; i < 5U; i++)
        {
            (void)snprintf(行, sizeof(行), "c%u %4u",
                           (unsigned)i, (unsigned)巡线_读取第几路(i));
            OLED_显示ASCII串(0, (int16_t)(16 + i * 9), 行);
        }
        OLED_刷新();

        printf("c0=%4u c1=%4u c2=%4u c3=%4u c4=%4u\r\n",
               (unsigned)巡线_读取第几路(0), (unsigned)巡线_读取第几路(1),
               (unsigned)巡线_读取第几路(2), (unsigned)巡线_读取第几路(3),
               (unsigned)巡线_读取第几路(4));

        HAL_Delay(200U);
    }
}

/* ============================== 对外接口 =================================== */

void 菜单_复位(void)
{
    菜单_深度 = 1U;
    菜单_栈[0] = 菜单树_取主表();
    菜单_标题栈[0] = 菜单树_取主标题();
    菜单_选中 = 0U;
    菜单_首项 = 0U;
}

static uint8_t 菜单_退出标志 = 0U;

void 菜单_请求退出(void)
{
    菜单_退出标志 = 1U;
}

void 菜单_运行(void)
{
    按键_初始化();
    OLED_初始化();
    菜单_复位();
    菜单_重画();
    菜单_退出标志 = 0U;

    for (;;)
    {
        btn_event_t 事件 = 按键_取事件();

        if (事件 != BTN_NONE)
        {
            菜单_处理(事件);
        }
        else if (菜单_选中项要滚() != 0U)
        {
            /* ---- 流水屏 ----
               选中项标题太长时，每隔 菜单_滚动间隔毫秒 把它往左挪一点。
               挪的时候要重画整帧（软件 I2C 约 25 ms），菜单里没有实时性要求，
               所以无所谓；真跑车的时候这里根本不会被执行到。 */
            uint32_t 现在 = HAL_GetTick();

            if ((uint32_t)(现在 - 滚动_上次时刻) >= 菜单_滚动间隔毫秒)
            {
                滚动_上次时刻 = 现在;
                滚动_相位 = (int16_t)(滚动_相位 + 菜单_滚动步进像素);
                菜单_重画();
            }
        }

        if (菜单_退出标志 != 0U) {
            break;
        }

        HAL_Delay(10U);
    }
}