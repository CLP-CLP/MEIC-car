/**
  ******************************************************************************
  * @file    line_follow.c
  * @brief   五路模拟红外巡线（模拟量 + 查表版，不用 PID）
  *
  *  ── 为什么用模拟量 ──
  *      只做二值化的话，"线在两路中间"和"线正好压在第 3 路"是一模一样的，
  *      位置分辨率就只有探头的机械间距（中间 20mm）—— 车会一跳一跳地走。
  *      这五个 HC-PM254 输出的是模拟电压，按每路自己标定出来的白底/黑线
  *      归一化以后，能算出**连续的位置**（mm），分辨率远好于 20mm。
  *      所以这里不用开关量查表，而是"模拟量算位置 + 手工折线表出差速"。
  *
  *  ── 三步（都不是 PID，没有任何微积分）──
  *      1. 读五路 ADC，用每路的黑白阈值反推出"黑度" 0~1；
  *      2. 按探头实际安装位置（-60/-20/0/+20/+60 mm）做**加权平均**，
  *         得到黑线相对车体中心线的位置，单位 mm（左负右正）；
  *      3. 拿这个位置去查 巡线_曲线表，线性插值出差速：
  *             左轮 = 速度 + 差速,  右轮 = 速度 - 差速
  *
  *  ── 和 PID 版的区别 ──
  *      · 没有 Kp/Ki/Kd、没有误差滤波、没有积分，**不做微分** ——
  *        之前"抖"主要就是 D 项在放大 ADC 噪声；
  *      · 位置→差速 是一条手工画的折线（表），一条直线段就是一个"档位"，
  *        想怎么改就改哪一段，不用管什么增益、相位、稳定余度；
  *      · 手感接近"比例控制"，但增益是分段可调的：
  *        中间几档给软一点（不抖），大偏差给猛一点（压得住线）。
  *
  *  ── 要调车就改这条折线（巡线_曲线表）──
  *      每行 {位置mm, 差速}，位置从小到大写，两点之间自动线性插值。
  *      想让车更贴线：把靠两端的差速加大；想让车更柔：减小。
  *      把 巡线_调试打印 改成 1，串口会打出实时的五路原始值、位置和差速，
  *      对着跑道看一遍就知道该改哪一段。
  *
  *  ── 拐角（L 形直角弯）──
  *      二值位图形态：(第 1 路 或 第 5 路) 压黑  且  (第 2/3/4 路) 至少一路压黑
  *      连续 巡线_拐角确认毫秒 -> 立刻刹车停车返回，交给调用方 左转()/右转()。
  *      必须先出现过一次"外侧没压线"的正常巡线形态，才解锁拐角判据 ——
  *      否则刚拐完弯还压在角上那段横线上时，下一轮 巡线() 会立刻又返回一次。
  *
  *  ── 丢线（五路都不黑）──
  *      保持上一次的差速继续走（车会顺着最后的方向把线找回来），
  *      巡线_丢线超时毫秒 还找不回来才停车返回。
  *
  *  ── "看到路口"到"车真的停住"之间到底慢在哪 ──
  *      以前每一轮的开销大致是：
  *          读五路 ADC（轮询）        ~250 µs
  *          OLED 整帧刷新（阻塞）     20~30 ms   ← 每 100 ms 来一次，一次全卡住
  *          拐角连续确认              6 ms
  *          刹车                      20 ms
  *      屏幕那 20~30 ms 是最大的一笔，而且它偏偏和"确认窗口"叠在一起，
  *      于是车在完全不知道传感器读数的状态下往前跑了一大截 —— 看着就是冲过路口。
  *
  *      现在：
  *          读五路                    ≈ 0（ADC + DMA 在后台扫，见 ir_sensor.c）
  *          OLED                      ~0.6 ms/片（分片送，见 menu_tree.c）
  *          拐角连续确认              2 ms
  *          刹车                      20 ms（这一项是机械的，改代码改不掉）
  *      也就是把"电路/软件造成的延迟"从 25 ms 以上压到 3 ms 以内，
  *      剩下的刹车距离只能靠降速或提前刹车量去调。
  *
  *  ⚠ 本文件使用中文标识符（UTF-8），需要 GCC 10 及以上。
  *     凡是以 HAL_ 开头的固定接口名一律保持英文。
  ******************************************************************************
  */

/* Includes ------------------------------------------------------------------*/
#include "main.h"
#include "line_follow.h"
#include "ir_sensor.h"
#include "motor.h"
#include "gray_calib.h"     /* 灰度_各路阈值[] / 灰度_各路强阈值[] */

#include <stdio.h>          /* 调试打印用（走 USB 虚拟串口，非阻塞） */

/* ============================== 位置 -> 差速 折线表 ======================== */
/*
 *  横坐标：黑线相对车体中心线的位置，单位 mm，左负右正
 *          （由模拟量加权平均算出来，见 巡线_算位置）
 *  纵坐标：差速，单位跟 速度 一样是 0~100 的占空比
 *          左轮 = 速度 + 差速，右轮 = 速度 - 差速
 *          差速 > 0 = 线偏右，往右修；< 0 = 往左修
 *
 *  一条直线段就是一个"档位"。中间几档特意给软（斜率小），
 *  免得车在线上小幅度来回蹭；靠两端的斜率大，压线更狠。
 */
typedef struct
{
    int8_t 位置;        /* mm */
    int8_t 差速;        /* 占空比 */
} 巡线_曲线点;

static const 巡线_曲线点 巡线_曲线表[] =
{
    /* 位置mm   差速 */
    {  -60,    -58 },       /* 只剩最左边那一路压线：大幅左转 */
    {  -45,    -48 },
    {  -30,    -32 },
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    {  +60,    +58 },       /* 只剩最右边那一路压线：大幅右转 */
};

#define 巡线_曲线点数   (sizeof(巡线_曲线表) / sizeof(巡线_曲线表[0]))

/* ============================== 可调参数 =================================== */

/** 五路总黑度低于这个值就认为"没看到线"（丢线）。
    正常压线时总黑度在 1.0 以上，纯白底接近 0。 */
#define 巡线_最小黑度和         0.15f

/** 标定跨度（黑-白）小于这个数，认为这一路标定不可信，退回二值位置 */
#define 巡线_最小标定跨度       80

/* ---------------------------- 拐角判据 ------------------------------------- */

/**
  * @brief 拐角触发形态
  *        1 = 外侧(第 1 路或第 5 路) + 内侧(第 2/3/4 路) 同时压黑   <- 默认
  *        0 = 至少 4 路同时压黑（只有十字/横线那种才出得来）
  */
#define 巡线_拐角用外侧加中间   1

/**
  * @brief 外侧那两路用什么阈值判"压黑"
  *        1 = 用 灰度_各路强阈值[]（白 + 3/4 跨度，比较"黑得实"）
  *        0 = 用 灰度_各路阈值[]（黑白中点，更灵敏，路口检测响应更快）
  * @note  外侧两路离中心 60mm，正常巡线根本碰不到线，是判拐角的关键信号。
  *        设为 0 后外侧感应更灵敏，拐角/路口响应更快，但若传感器标定不准
  *        可能在白色地面上误判（此时需重新标定灰度）。
  */
#define 巡线_外侧用强阈值       0

/** 拐角形态要连续出现多少毫秒才算数（滤毛刺；越大越保守）
    ⚠ 这个值直接决定"看到路口"到"决定停车"之间的延迟，也就是冲出去的那一截。
      原来的 6 ms 在 40 的速度下大约是 3~4 mm，看着不多，但加上屏幕刷新的
      20~30 ms 蒙眼时间，落点就明显偏了。屏幕改成不阻塞（见 menu_tree.c）之后，
      这里可以把窗口收紧：ADC 现在每秒扫约 9.5 千帧，2 ms 已经是 ~19 个连续
      样本都在说"到路口了"，滤毛刺够用。
      如果减到 2 以后偶发误停（白底反光、传感器标定不准），再往回调到 3~4。*/
#define 巡线_拐角确认毫秒       2U

/* ---------------------------- 丢线处理 ------------------------------------- */

/** 看不到线之后，保持上一次差速最多走多少毫秒，超时才停车返回。
    （调小 = 更早放弃找线；调大 = 更能容忍线断/反光）*/
#define 巡线_丢线超时毫秒       600U

/** 兜底：单次巡线最多跑多少毫秒（防止条件永远不满足时卡死在这里） */
#define 巡线_最长毫秒           20000U

/* ---------------------------- 输出 ----------------------------------------- */

/**
  * @brief 差速太大时，内侧轮允不允许反转
  *        0 = 不允许（默认，内侧轮最慢到 0，车不会原地打转，稳）
  *        1 = 允许（急弯甩得更狠，但容易转过头）
  */
#define 巡线_允许倒转           0

/** 结束巡线时要不要主动刹车：1 = 刹车 巡线_刹车毫秒 再断电（停得准），0 = 直接滑行 */
#define 巡线_停车刹车           1

/**
  * @brief 刹车方式
  *        0 = 主动刹车（电机_刹车，短路绕组，靠反电动势制动）  <- 原方式
  *        1 = 倒车刹车（短暂反转推一把，停得更快更准）
  * @note  倒车刹车停得更准，但如果功率/时长没调好可能倒弹。
  *        先从小功率（10~15）试，不够再加。
  */
#define 巡线_倒车刹车模式       1

/** 倒车刹车时的反转功率（0~100，软件占空比），仅在 巡线_倒车刹车模式=1 时有效 */
#define 巡线_倒车刹车功率       100

/** 刹车时长（毫秒） */
#define 巡线_刹车毫秒           20U

/** 调试打印：1 = 每 100ms 往 USB 串口打一行原始值/位置/差速（调曲线用） */
#define 巡线_调试打印           0

/* ============================== 私有数据 =================================== */

/** 上一次 巡线() 的结束原因（调试用） */
volatile 巡线_结束原因 巡线_上次结束原因 = 巡线_结束_拐角;

/* == 每帧回调：任务运行中由巡线/转向循环自动调用，用于实时刷新主屏幕 == */
void (*巡线_每帧回调)(void) = NULL;

/** 最近一次的位图与位置（调试用） */
static volatile uint8_t 巡线_上次位图   = 0U;
static volatile float   巡线_上次位置   = 0.0f;

/** 五个探头相对车体中心线的横向位置（mm）。
    与 ir_sensor.c 的 巡线_位置表 同源，改机械结构只改 ir_sensor.h 两个宏。 */
static const float 巡线_探头位置[巡线_路数] =
{
    -(float)(巡线_间距_中间 + 巡线_间距_外侧),      /* 第 1 路：-60mm */
    -(float)巡线_间距_中间,                         /* 第 2 路：-20mm */
    0.0f,                                           /* 第 3 路：  0mm */
    +(float)巡线_间距_中间,                         /* 第 4 路：+20mm */
    +(float)(巡线_间距_中间 + 巡线_间距_外侧),      /* 第 5 路：+60mm */
};

/* ============================== 私有函数 =================================== */

/**
  * @brief  把某一路的原始 ADC 值换算成 0~1 的"黑度"
  *
  *  gray_calib 每路只存了两个数（每路独立标定）：
  *      灰度_各路阈值[i]   = (白 + 黑) / 2
  *      灰度_各路强阈值[i] = 白 + (黑 - 白) × 3/4
  *  反推一下就得到这一路的白底和黑线读数：
  *      跨度 = 4 × (强阈值 - 阈值)      白底 = 阈值 - 跨度/2
  *  于是 黑度 = (原始值 - 白底) / 跨度，卡在 0~1：
  *      纯白底 -> 0（不参与加权），纯黑线 -> 1（满权重），压一半 -> 0.5。
  *  这一步就是"发挥模拟传感器作用"的关键：不是只判黑/白，而是量"有多黑"。
  */
static float 巡线_黑度(uint16_t 原始值, uint8_t 第几路)
{
    int32_t 阈值   = (int32_t)灰度_各路阈值[第几路];
    int32_t 强阈值 = (int32_t)灰度_各路强阈值[第几路];
    int32_t 跨度   = 4 * (强阈值 - 阈值);
    int32_t 白底;
    float   黑度;

    /* 没校准 / 校准异常时给个兜底跨度，避免除零和乱跳 */
    if (跨度 < 巡线_最小标定跨度) {
        跨度 = 巡线_最小标定跨度;
    }

    白底 = 阈值 - 跨度 / 2;

    黑度 = (float)((int32_t)原始值 - 白底) / (float)跨度;

    if (黑度 < 0.0f) 黑度 = 0.0f;
    if (黑度 > 1.0f) 黑度 = 1.0f;

    return 黑度;
}

/**
  * @brief  一次性取回五路最新值 + 二值化位图
  * @param  原始值  输出：五路 ADC 原始值
  * @retval 位图，bit0~bit4 = 第 1~5 路，1 = 该路压黑
  * @note   二值位图只用来判拐角；算位置用的是上面的模拟量。
  *
  *         用 巡线_取最新帧() 一次读回五路：ADC 由 DMA 在后台连续扫描
  *         （见 ir_sensor.c），这里只是读内存，耗时纳秒级，而且五路
  *         一定属于同一帧，不会出现"前两路是这一轮、后三路是上一轮"的错位。
  */
static uint8_t 巡线_读位图(uint16_t *原始值)
{
    uint8_t 图 = 0U;
    uint8_t i;

    巡线_取最新帧(原始值);

    for (i = 0U; i < 巡线_路数; i++)
    {
        if (原始值[i] >= 灰度_各路阈值[i]) {
            图 |= (uint8_t)(1U << i);
        }
    }

    巡线_上次位图 = 图;
    return 图;
}

/**
  * @brief  用模拟量算黑线相对车体中心线的位置（加权平均）
  * @param  原始值   五路 ADC 原始值
  * @param  位置     输出：位置，单位 mm，左负右正
  * @param  黑度和   输出：五路黑度之和（用来判有没有看到线）
  * @retval 1 = 位置有效，0 = 五路都不黑（丢线）
  * @note   线走在两路中间时，两路各有一半黑度，算出来的位置就在两路中间，
  *         所以分辨率不受 20mm 的机械间距限制 —— 这是模拟量的价值所在。
  */
static uint8_t 巡线_算位置(const uint16_t *原始值, float *位置, float *黑度和)
{
    float   和    = 0.0f;
    float   加权 = 0.0f;
    uint32_t i;

    for (i = 0U; i < 巡线_路数; i++)
    {
        float 黑度 = 巡线_黑度(原始值[i], (uint8_t)i);

        if (黑度 > 0.0f)
        {
            和   += 黑度;
            加权 += 黑度 * 巡线_探头位置[i];
        }
    }

    *黑度和 = 和;

    if (和 < 巡线_最小黑度和) {
        return 0U;              /* 五路都不黑 -> 丢线 */
    }

    *位置 = 加权 / 和;
    巡线_上次位置 = *位置;
    return 1U;
}

/**
  * @brief  位置(mm) -> 差速 的分段折线（两点之间线性插值，两端取端点值）
  * @param  位置  线位置 mm，左负右正
  * @retval 差速（左轮 = 速度 + 差速，右轮 = 速度 - 差速）
  */
static int 巡线_查曲线(float 位置)
{
    uint8_t i;

    if (位置 <= (float)巡线_曲线表[0].位置) {
        return (int)巡线_曲线表[0].差速;
    }
    if (位置 >= (float)巡线_曲线表[巡线_曲线点数 - 1U].位置) {
        return (int)巡线_曲线表[巡线_曲线点数 - 1U].差速;
    }

    for (i = 1U; i < 巡线_曲线点数; i++)
    {
        float x1 = (float)巡线_曲线表[i].位置;

        if (位置 <= x1)
        {
            float x0 = (float)巡线_曲线表[i - 1U].位置;
            float y0 = (float)巡线_曲线表[i - 1U].差速;
            float y1 = (float)巡线_曲线表[i].差速;

            return (int)(y0 + (y1 - y0) * (位置 - x0) / (x1 - x0));
        }
    }

    return 0;
}

/**
  * @brief  由基准速度和差速算出左右轮实际占空比（含限幅）
  */
static void 巡线_算输出(int 速度, int 差速, int *左轮, int *右轮)
{
    int 左 = 速度 + 差速;
    int 右 = 速度 - 差速;

#if 巡线_允许倒转
    if (左 < -100) 左 = -100;
    if (右 < -100) 右 = -100;
#else
    if (左 < 0) 左 = 0;
    if (右 < 0) 右 = 0;
#endif

    if (左 > 100) 左 = 100;
    if (右 > 100) 右 = 100;

    *左轮 = 左;
    *右轮 = 右;
}

/** 按差速把左右轮写进电机 */
static void 巡线_输出(int 速度, int 差速)
{
    int 左;
    int 右;

    巡线_算输出(速度, 差速, &左, &右);
    电机_设置双轮((int16_t)左, (int16_t)右);
}

/**
  * @brief  停车：先刹车一小会儿再断电滑行
  * @note   定点停车要停得准，光靠 电机_全部停止()（断电滑行）会冲出去一截。
  *         这里用 HAL_GetTick() 空转计时，不用 HAL_Delay()。
  */
static void 巡线_停车(void)
{
#if 巡线_停车刹车
    uint32_t 开始时刻 = HAL_GetTick();

#if 巡线_倒车刹车模式
    int16_t 功率 = (int16_t)巡线_倒车刹车功率;
    电机_设置双轮(-功率, -功率);
#else
    电机_刹车(电机_左);
    电机_刹车(电机_右);
#endif

    while ((uint32_t)(HAL_GetTick() - 开始时刻) < 巡线_刹车毫秒)
    {
        /* 空转等刹车时间 */
    }
#endif

    电机_全部停止();
}

#if 巡线_调试打印
/**
  * @brief  每 100ms 打一行调试信息（printf 走 USB 虚拟串口，非阻塞）
  * @note   POS 是位置 ×10 的整数（+12.3mm 打成 +123），
  *         因为 platformio.ini 默认没开 printf 的浮点支持。
  *         MAP 是二值位图（判拐角用的），DIFF 是查表查出来的差速。
  */
static void 巡线_打印(uint32_t 现在, uint32_t *上次时刻, const uint16_t *原始值,
                      uint8_t 位图, float 位置, int 速度, int 差速)
{
    int      位置十分 = (int)(位置 * 10.0f);
    unsigned 幅度;
    int      左;
    int      右;

    if ((uint32_t)(现在 - *上次时刻) < 100U) {
        return;
    }
    *上次时刻 = 现在;

    幅度 = (unsigned)((位置十分 < 0) ? -位置十分 : 位置十分);
    巡线_算输出(速度, 差速, &左, &右);

    printf("ir %4u %4u %4u %4u %4u | map 0x%02X | pos %c%u.%u mm | diff %4d | L%3d R%3d%s\r\n",
           原始值[0], 原始值[1], 原始值[2], 原始值[3], 原始值[4],
           位图,
           (位置十分 < 0) ? '-' : '+',
           幅度 / 10U, 幅度 % 10U,
           差速,
           左, 右,
           ((左 != 速度 + 差速) || (右 != 速度 - 差速)) ? " CLIP" : "");
}
#endif

/* ============================== 对外接口 =================================== */

uint8_t 巡线_取上次位图(void)
{
    return 巡线_上次位图;
}

float 巡线_取最后位置(void)
{
    return 巡线_上次位置;
}

/**
  * @brief  沿黑线走，出现拐角形态就停车返回（阻塞）
  *
  *  每一轮就干这几件事：
  *      ① 读五路 -> 模拟量算位置(mm) + 二值位图
  *      ② 兜底超时？
  *      ③ 拐角形态（外侧+内侧同时压黑）持续够久 -> 立刻停车返回
  *      ④ 看不到线 -> 保持上一次差速继续走，超时才停车返回
  *      ⑤ 否则 差速 = 查曲线(位置)，写电机
  */
int 巡线(int 速度)
{
    uint32_t 开始时刻 = HAL_GetTick();
    uint32_t 拐角开始 = 0U;
    uint32_t 丢线开始 = 0U;
#if 巡线_调试打印
    uint32_t 打印时刻 = 开始时刻;
#endif

    uint8_t  拐角中 = 0U;       /* 1 = 拐角形态正在连续出现 */
    uint8_t  丢线中 = 0U;       /* 1 = 正处在丢线保持状态 */
    uint8_t  已出角 = 0U;       /* 1 = 已出现过正常巡线形态，拐角判据解锁 */
    int      差速   = 0;        /* 上一次有效的差速（丢线时继续用它） */

    if (速度 > 100) 速度 = 100;
    if (速度 < 0)   速度 = 0;

    while (1)
    {
        uint16_t 原始值[巡线_路数];
        uint8_t  位图;
        uint8_t  有线;
        uint8_t  外侧黑;
        uint8_t  中间黑;
        uint8_t  拐角样;
        float    位置   = 0.0f;
        float    黑度和 = 0.0f;
        uint32_t 现在;

        /* ---- ① 采样：二值位图 + 模拟量位置 ---- */
        位图 = 巡线_读位图(原始值);
        有线 = 巡线_算位置(原始值, &位置, &黑度和);
        现在 = HAL_GetTick();

        /* ---- ② 兜底超时：任何情况下都不会永久卡死 ---- */
        if ((uint32_t)(现在 - 开始时刻) >= 巡线_最长毫秒)
        {
            巡线_上次结束原因 = 巡线_结束_超时;
            巡线_停车();
            return (int)(uint32_t)(现在 - 开始时刻);
        }

        /* ---- ③ 拐角形态 ----
           外侧两路（±60mm）正常巡线碰不到线，一压黑说明线拐到旁边去了；
           同时内侧 2/3/4 至少一路还压着，说明车正压在角上那段线上。 */
#if 巡线_外侧用强阈值
        外侧黑 = (((原始值[0] >= 灰度_各路强阈值[0]) ||
                   (原始值[4] >= 灰度_各路强阈值[4])) ? 1U : 0U);
#else
        外侧黑 = (((位图 & 0x01U) != 0U) || ((位图 & 0x10U) != 0U)) ? 1U : 0U;
#endif

        中间黑 = ((位图 & 0x0EU) != 0U) ? 1U : 0U;      /* bit1/bit2/bit3 */

        /* 解锁：先看到一次"线在中间、外侧没压线"的正常形态 */
        if (外侧黑 == 0U) {
            已出角 = 1U;
        }

#if 巡线_拐角用外侧加中间
        拐角样 = ((外侧黑 != 0U) && (中间黑 != 0U)) ? 1U : 0U;
#else
        {
            uint8_t 计数 = 0U, 临时 = 位图;

            while (临时 != 0U) {
                计数 = (uint8_t)(计数 + (临时 & 1U));
                临时 >>= 1;
            }
            拐角样 = (计数 >= 4U) ? 1U : 0U;
        }
#endif

        if ((已出角 != 0U) && (拐角样 != 0U))
        {
            if (拐角中 == 0U) {
                拐角中   = 1U;
                拐角开始 = 现在;
            } else if ((uint32_t)(现在 - 拐角开始) >= 巡线_拐角确认毫秒) {
                /* 到角了：立刻停（停位最准）。
                   别改成"先往前蹭再停"：那样车会被带进拐弯中途，定点停车就偏了。 */
                巡线_上次结束原因 = 巡线_结束_拐角;
                巡线_停车();
                return (int)(uint32_t)(现在 - 开始时刻);
            }
        }
        else
        {
            拐角中 = 0U;
        }

        /* ---- ④ 丢线 / ⑤ 查曲线 ---- */
        if (有线 == 0U)
        {
            if (丢线中 == 0U) {
                丢线中   = 1U;
                丢线开始 = 现在;
            } else if ((uint32_t)(现在 - 丢线开始) >= 巡线_丢线超时毫秒) {
                巡线_上次结束原因 = 巡线_结束_丢线;
                巡线_停车();
                return (int)(uint32_t)(现在 - 开始时刻);
            }
            /* 保持上一次的 差速 继续走：车会顺着最后的方向把线找回来 */
        }
        else
        {
            丢线中 = 0U;
            差速   = 巡线_查曲线(位置);
        }

        巡线_输出(速度, 差速);

        /* == 主屏幕刷新 ==
           注意这里**每轮都调**，不再自己按 100 ms 限速：回调必须是"发一小片
           就返回"的非阻塞版本（主屏幕_画一帧分片），一帧分几十次送完。
           以前是每 100 ms 调一次整帧刷新的阻塞版本，一次把 CPU 卡住 20~30 ms，
           车正好在那段时间里冲过路口。限速交给回调自己（见 menu_tree.c）。 */
        if (巡线_每帧回调 != NULL) {
            巡线_每帧回调();
        }

#if 巡线_调试打印
        巡线_打印(现在, &打印时刻, 原始值, 位图, 位置, 速度, 差速);
#endif
    }
}