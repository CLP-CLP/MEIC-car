/**
 ******************************************************************************
 * @file    turn.c
 * @brief   左转 / 右转 —— 三级预警 + 电磁刹车，防转过头
 *
 *  设计要点（仿 line_follow.c 模式）：
 *    1. 零 HAL_Delay()：全用 HAL_GetTick() 差值计时
 *    2. 三级预警（从远到近）：
 *       · 第一级：外侧探头碰到线 → 降到速度 6（预警）
 *       · 第二级：中间探头值越过"弱阈值" → 降到速度 3（线在靠近，提前收油）
 *       · 第三级：中间探头值越过"标准阈值"并持续 1ms → 立刻电磁刹车
 *    3. 弱阈值 = 2 × 标准阈值 − 强阈值：靠近白底那一侧，比标准阈值先触发
 *    4. 到位后 电磁刹车 15ms（短路绕组制动）+ 断电：不停车滑行
 *    5. 传感器 DMA 后台采样：巡线_取最新帧() 只读内存
 *    6. 兜底超时 2000ms：防止故障永久卡死
 ******************************************************************************
 */

/* Includes ------------------------------------------------------------------*/
#include "main.h"
#include "turn.h"
#include "motor.h"
#include "ir_sensor.h"
#include "gray_calib.h"

void (*转向_每帧回调)(void) = NULL;

/* ============================== 可调参数 =================================== */

/** 阶段 1：蠕行前进多久才开转（ms） */
#define 转向_蠕行毫秒           100U

/** 阶段 1 蠕行速度 */
#define 转向_蠕行速度           5

/** 目标巡航速度（外轮推、内轮刹死的转弯最高速） */
#define 转向_目标速度           35

/** 起始速度 */
#define 转向_起始速度           5

/** 渐进加速步长 */
#define 转向_加速步长           2

/** 第一级：外侧碰线 → 预警减速 */
#define 转向_一级速度           6

/** 第二级：中间接近（弱阈值）→ 慢速逼近 */
#define 转向_二级速度           3

/** 第三级：中间压线确认后电磁刹车时长（ms） */
#define 转向_刹车毫秒           15U

/** 中间三路连续压黑多少毫秒算"转到位" */
#define 转向_到位确认毫秒       1U

/** 兜底超时（ms） */
#define 转向_最长毫秒           2000U

/* ============================== 内部辅助 =================================== */

/**
  * @brief  初始化弱阈值（中间三路）
  *         弱阈值 = 2 × 标准阈值 − 强阈值 = 白底 + 跨度/4
  *         用于"线在靠近"的早期感知，比标准中点阈值先触发。
  * @param  弱 输出数组[3]，对应传感器下标 1/2/3
  */
static void 转向_算弱阈值(uint16_t *弱)
{
    uint8_t i;
    for (i = 0U; i < 3U; i++) {
        int32_t 标 = (int32_t)灰度_各路阈值[i + 1U];
        int32_t 强 = (int32_t)灰度_各路强阈值[i + 1U];
        int32_t 值 = 2 * 标 - 强;
        if (值 < 0)    值 = 0;
        if (值 > 4095) 值 = 4095;
        弱[i] = (uint16_t)值;
    }
}

/**
  * @brief  中间探头是否越过标准阈值（第三级：转到位）
  */
static uint8_t 转向_中间到位(const uint16_t *r)
{
    return ((r[1] >= 灰度_各路阈值[1]) ||
            (r[2] >= 灰度_各路阈值[2]) ||
            (r[3] >= 灰度_各路阈值[3])) ? 1U : 0U;
}

/**
  * @brief  中间探头是否越过弱阈值（第二级：线在靠近）
  */
static uint8_t 转向_中间接近(const uint16_t *r, const uint16_t *弱)
{
    return ((r[1] >= 弱[0]) ||
            (r[2] >= 弱[1]) ||
            (r[3] >= 弱[2])) ? 1U : 0U;
}

/**
  * @brief  外侧探头是否压线（第一级：线在侧面）
  */
static uint8_t 转向_外侧压线(const uint16_t *r)
{
    return ((r[0] >= 灰度_各路阈值[0]) ||
            (r[4] >= 灰度_各路阈值[4])) ? 1U : 0U;
}

/**
  * @brief  电磁刹车指定轮子 15ms，然后断电
  *         仿 巡线_停车()：刹车用短路绕组制动，停止比滑行快得多。
  */
static void 转向_刹车(电机_编号 轮)
{
    uint32_t 刹始 = HAL_GetTick();
    电机_刹车(轮);
    while ((uint32_t)(HAL_GetTick() - 刹始) < 转向_刹车毫秒) {
        if (转向_每帧回调 != NULL) {
            转向_每帧回调();
        }
    }
    电机_全部停止();
}

/* ============================== 左转 ====================================== */

void 左转(void)
{
    uint32_t 开始时刻 = HAL_GetTick();
    uint32_t 现在;
    uint32_t 到位开始 = 0U;
    uint8_t  到位中   = 0U;
    uint16_t 原始值[5];
    uint16_t 弱阈值[3];
    int16_t  当前速度 = 转向_起始速度;

    转向_算弱阈值(弱阈值);

    /* ---- 阶段 1：慢速蠕行过角 ---- */
    while ((uint32_t)(HAL_GetTick() - 开始时刻) < 转向_蠕行毫秒) {
        电机_设置双轮(转向_蠕行速度, 转向_蠕行速度);
        if (转向_每帧回调 != NULL) {
            转向_每帧回调();
        }
    }

    /* ---- 阶段 2：渐进加速 + 原地左转 ---- */
    开始时刻 = HAL_GetTick();
    当前速度 = 转向_起始速度;
    电机_设置双轮(0, 当前速度);   /* 左轮刹死，右轮前推 = 原地左转 */

    while (1) {
        巡线_取最新帧(原始值);
        现在 = HAL_GetTick();

        /* 兜底超时 */
        if ((uint32_t)(现在 - 开始时刻) >= 转向_最长毫秒) {
            电机_全部停止();
            return;
        }

        /* ---- 第三级：中间压线 → 转到位确认 ---- */
        if (转向_中间到位(原始值)) {
            if (到位中 == 0U) {
                到位中   = 1U;
                到位开始 = 现在;
            } else if ((uint32_t)(现在 - 到位开始) >= 转向_到位确认毫秒) {
                转向_刹车(电机_右);   /* 刹右轮 → 立即停 */
                return;
            }
        } else {
            到位中 = 0U;
        }

        /* ---- 第二级：中间接近（弱阈值）→ 慢速逼近 ---- */
        if (!到位中 && 转向_中间接近(原始值, 弱阈值)) {
            当前速度 = 转向_二级速度;
        }
        /* ---- 第一级：外侧碰线 → 预警减速 ---- */
        else if (转向_外侧压线(原始值)) {
            当前速度 = 转向_一级速度;
        }
        /* ---- 还没看到线 → 渐进加速 ---- */
        else if (当前速度 < 转向_目标速度) {
            当前速度 += 转向_加速步长;
            if (当前速度 > 转向_目标速度) 当前速度 = 转向_目标速度;
        }

        电机_设置双轮(0, 当前速度);

        if (转向_每帧回调 != NULL) {
            转向_每帧回调();
        }
    }
}

/* ============================== 右转 ====================================== */

void 右转(void)
{
    uint32_t 开始时刻 = HAL_GetTick();
    uint32_t 现在;
    uint32_t 到位开始 = 0U;
    uint8_t  到位中   = 0U;
    uint16_t 原始值[5];
    uint16_t 弱阈值[3];
    int16_t  当前速度 = 转向_起始速度;

    转向_算弱阈值(弱阈值);

    /* ---- 阶段 1：慢速蠕行过角 ---- */
    while ((uint32_t)(HAL_GetTick() - 开始时刻) < 转向_蠕行毫秒) {
        电机_设置双轮(转向_蠕行速度, 转向_蠕行速度);
        if (转向_每帧回调 != NULL) {
            转向_每帧回调();
        }
    }

    /* ---- 阶段 2：渐进加速 + 原地右转 ---- */
    开始时刻 = HAL_GetTick();
    当前速度 = 转向_起始速度;
    电机_设置双轮(当前速度, 0);   /* 右轮刹死，左轮前推 = 原地右转 */

    while (1) {
        巡线_取最新帧(原始值);
        现在 = HAL_GetTick();

        /* 兜底超时 */
        if ((uint32_t)(现在 - 开始时刻) >= 转向_最长毫秒) {
            电机_全部停止();
            return;
        }

        /* ---- 第三级：中间压线 → 转到位确认 ---- */
        if (转向_中间到位(原始值)) {
            if (到位中 == 0U) {
                到位中   = 1U;
                到位开始 = 现在;
            } else if ((uint32_t)(现在 - 到位开始) >= 转向_到位确认毫秒) {
                转向_刹车(电机_左);   /* 刹左轮 → 立即停 */
                return;
            }
        } else {
            到位中 = 0U;
        }

        /* ---- 第二级：中间接近（弱阈值）→ 慢速逼近 ---- */
        if (!到位中 && 转向_中间接近(原始值, 弱阈值)) {
            当前速度 = 转向_二级速度;
        }
        /* ---- 第一级：外侧碰线 → 预警减速 ---- */
        else if (转向_外侧压线(原始值)) {
            当前速度 = 转向_一级速度;
        }
        /* ---- 还没看到线 → 渐进加速 ---- */
        else if (当前速度 < 转向_目标速度) {
            当前速度 += 转向_加速步长;
            if (当前速度 > 转向_目标速度) 当前速度 = 转向_目标速度;
        }

        电机_设置双轮(当前速度, 0);

        if (转向_每帧回调 != NULL) {
            转向_每帧回调();
        }
    }
}