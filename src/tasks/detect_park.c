/**
 ******************************************************************************
 * @file    detect_park.c
 * @brief   巡线检测停车：沿黑线走，识别垂直黑线（库边），自动停车
 *
 *  沿边巡线一个个路口走过去，每到一个路口就往前蹭一点点，
 *  看中间三路有没有压上横线（车库入口那条线）；
 *  压上了就说明到车库门口了，然后走一段尺子段，
 *  按耗时分辨 40cm 车库（倒库）还是 25cm 车库（侧方）。
 *
 *  耗时优先从 Flash 标定值读取（车库时间标定），没标定过则退回 1000ms 经验阈值。
 ******************************************************************************
 */

/* Includes ------------------------------------------------------------------*/
#include "detect_park.h"

#include "calib.h"
#include "gray_calib.h"         /* 灰度_取车库时间() */
#include "ir_sensor.h"
#include "line_follow.h"
#include "motor.h"
#include "turn.h"

#define 检测_蹭线阈值       600     /* 中间三路大于这个值就算压上横线（与侦探_蹭线阈值一致） */

void 巡线检测停车(void)
{
    uint16_t 车库40毫秒 = 0U;
    uint16_t 车库25毫秒 = 0U;
    int      经过时间;
    int      差40;
    int      差25;
    uint8_t  已标定;

    HAL_Delay(2000U);

    /* ---- 沿边巡线到车库门口（逻辑与 侦探_走到横线() 完全一致） ---- */
    while (1) {
        巡线(40);                           /* 与标定时 侦探_走到横线() 的速度一致 */

        电机_设置双轮(10, 10);              /* 往前蹭，探头压横线 */
        HAL_Delay(60);
        电机_全部停止();
        HAL_Delay(80);

        if (巡线_读取第几路(1) > 检测_蹭线阈值
         || 巡线_读取第几路(2) > 检测_蹭线阈值
         || 巡线_读取第几路(3) > 检测_蹭线阈值) {
            break;                          /* 到车库门口了 */
        }

        左转();                              /* 不是这个路口，继续走 */
    }

    /* ---- 尺子段：巡线(10)，与标定时完全一致 ---- */
    经过时间 = 巡线(10);

    /* ---- 用 Flash 标定值做最近邻匹配（与 detective() 逻辑一致） ---- */
    已标定 = 灰度_取车库时间(&车库40毫秒, &车库25毫秒);

    if (已标定 != 0U) {
        差40 = (经过时间 > (int)车库40毫秒) ? (经过时间 - (int)车库40毫秒)
                                            : ((int)车库40毫秒 - 经过时间);
        差25 = (经过时间 > (int)车库25毫秒) ? (经过时间 - (int)车库25毫秒)
                                            : ((int)车库25毫秒 - 经过时间);

        if (差40 <= 差25) {
            /* 40 cm 车库 -> 倒车入库 */
            电机_全部停止();
            HAL_Delay(200);
            校准();
            HAL_Delay(500);
            电机_设置双轮(-20, -20);
            HAL_Delay(120);
            电机_全部停止();
        } else {
            /* 25 cm 车库 -> 侧方停车 */
            电机_全部停止();
            HAL_Delay(200);
            校准();
            HAL_Delay(500);
            电机_设置双轮(20, 20);
            HAL_Delay(120);
            电机_全部停止();
        }
    } else {
        /* 还没做过车库时间标定，退回经验阈值兜底 */
        if (经过时间 > 1000) {
            电机_全部停止();
            HAL_Delay(200);
            校准();
            HAL_Delay(500);
            电机_设置双轮(-20, -20);
            HAL_Delay(120);
            电机_全部停止();
        } else {
            电机_全部停止();
            HAL_Delay(200);
            校准();
            HAL_Delay(500);
            电机_设置双轮(20, 20);
            HAL_Delay(120);
            电机_全部停止();
        }
    }
}