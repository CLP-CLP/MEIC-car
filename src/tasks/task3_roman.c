/**
 ******************************************************************************
 * @file    task3_roman.c
 * @brief   基础任务三：罗马数字识别定点停车
 *
 *  题目：从 BC 边车库出发，识别车前的罗马数字卡片，停在对应点。
 *        I -> A 点    III -> B 点    V -> C 点    VII -> D 点
 *
 *  场地：A 左上、B 右上、C 右下、D 左下，BC 是右边那条边。
 *  车停在 BC 边车库（正方形内侧），车头朝正方形外、正对着卡片。
 *
 *  车头朝外时，左转 = 朝 B（图上方），右转 = 朝 C（图下方）
 *  从 BC 边中点出发，往 B 走：第 1 个拐角是 B，第 2 个是 A
 *                    往 C 走：第 1 个拐角是 C，第 2 个是 D
 *
 *  OLED 实时显示当前读到的罗马数字 + 目标点预览 + 稳定性进度条，
 *  连续 N 次一致后才返回，避免误读。
 ******************************************************************************
 */

/* Includes ------------------------------------------------------------------*/
#include "task3_roman.h"

#include "ir_sensor.h"
#include "line_follow.h"
#include "motor.h"
#include "oled.h"
#include "proto.h"
#include "servo.h"
#include "turn.h"

#include <stdio.h>

/* ============================== 参数 ======================================= */

#define 任务三_认卡超时毫秒   8000U    /* 最多等 8 秒认卡片；认不出来就原地不动 */
#define 任务三_巡线速度       巡线_默认速度   /* 沿边巡线的速度：全工程统一，见 line_follow.h */
#define 任务三_出库速度       35       /* 从车库开出来找黑线的速度 */
#define 任务三_出库超时毫秒   1500U    /* 出库最多开这么久，找不到线就停下（防跑飞） */
#define 任务三_触线阈值       600U     /* "刚碰到线"的阈值：必须比 1500 小，
                                          因为 左转()/右转() 等的是中间路 >= 1500 */
#define 任务三_稳定次数       5U       /* 连续多少次相同才算"稳定识别" */
#define 任务三_采样间隔毫秒   60U      /* 两次采样间隔 */

/* ============================== 私有函数 =================================== */

/**
  * @brief  读出罗马数字卡片，带 OLED 实时显示 + 稳定检测
  *
  *  每 60 ms 采样一次 OpenMV 传来的罗马数字（协议_取卡面），
  *  在 OLED 上实时显示当前数字和对应目标点。
  *  连续 5 次读到同一个数字才算"稳定"，然后返回。
  *
  * @retval 'A' / 'B' / 'C' / 'D'；认不出来返回 0
  */
static uint8_t 任务三_读卡片(void)
{
    uint8_t  罗马;
    uint8_t  上次罗马 = 0U;
    uint8_t  连续次数 = 0U;
    uint32_t 开始时刻;
    uint8_t  稳定罗马 = 0U;

    舵机_设置角度(舵机_垂直, 70);
    HAL_Delay(300U);

    开始时刻 = HAL_GetTick();

    while (1U)
    {
        罗马 = 协议_取卡面();

        /* 有效值 (1/3/5/7) 且和上次一样 → 累加稳定计数 */
        if ((罗马 == 1U || 罗马 == 3U || 罗马 == 5U || 罗马 == 7U)
            && (罗马 == 上次罗马))
        {
            连续次数++;
        }
        else
        {
            连续次数 = (罗马 == 1U || 罗马 == 3U
                     || 罗马 == 5U || 罗马 == 7U) ? 1U : 0U;
            上次罗马 = 罗马;
        }

        /* ---- OLED 实时显示 ---- */
        {
            char       行[24];
            uint8_t    条宽;
            uint8_t    目标 = 0U;

            OLED_清屏();

            /* 标题栏反白 */
            OLED_填充矩形(0, 0, OLED_宽 - 1, 15, OLED_亮);
            OLED_显示中文串色(2, 0, "卡片识别", OLED_灭);

            if (上次罗马 == 0U)
            {
                OLED_显示中文串(0, 22, "识别中...");
                OLED_显示中文串(0, 40, "等待卡片");
            }
            else
            {
                /* 罗马数字 → 文本 */
                switch (上次罗马)
                {
                    case 1U: (void)snprintf(行, sizeof(行), "I   -> A点"); break;
                    case 3U: (void)snprintf(行, sizeof(行), "III -> B点"); break;
                    case 5U: (void)snprintf(行, sizeof(行), "V   -> C点"); break;
                    case 7U: (void)snprintf(行, sizeof(行), "VII -> D点"); break;
                    default: (void)snprintf(行, sizeof(行), "?");
                             break;
                }
                OLED_显示中文串(0, 22, 行);

                /* 目标预览 */
                switch (上次罗马)
                {
                    case 1U: 目标 = 'A'; break;
                    case 3U: 目标 = 'B'; break;
                    case 5U: 目标 = 'C'; break;
                    case 7U: 目标 = 'D'; break;
                    default: break;
                }
                if (目标 != 0U) {
                    (void)snprintf(行, sizeof(行), "去 %c 点", (char)目标);
                    OLED_显示中文串(0, 40, 行);
                }
            }

            /* 稳定性进度条 */
            if (连续次数 > 0U)
            {
                条宽 = (uint8_t)(((uint16_t)连续次数
                       * ((uint16_t)OLED_宽 - 2U))
                       / (uint16_t)任务三_稳定次数);
                if (条宽 > ((uint8_t)OLED_宽 - 2U))
                    { 条宽 = (uint8_t)(OLED_宽 - 2U); }

                OLED_画矩形(0, 55, OLED_宽 - 1, 63, OLED_亮);
                if (条宽 > 0U)
                {
                    OLED_填充矩形(1, 56, (int16_t)(条宽), 62, OLED_亮);
                }
            }

            OLED_刷新();
        }

        /* ---- 稳定了 → 返回 ---- */
        if (连续次数 >= 任务三_稳定次数)
        {
            稳定罗马 = 上次罗马;
            break;
        }

        /* ---- 超时 ---- */
        if ((uint32_t)(HAL_GetTick() - 开始时刻) > 任务三_认卡超时毫秒)
        {
            break;
        }

        HAL_Delay(任务三_采样间隔毫秒);
    }

    /* 没认出来：屏幕显示超时 */
    if (稳定罗马 == 0U)
    {
        OLED_清屏();
        OLED_显示中文串(2, 0, "卡片识别");
        OLED_显示中文串(0, 22, "超时 未识别");
        OLED_刷新();
        HAL_Delay(1500U);
        电机_全部停止();
        return 0U;
    }

    /* 舵机回中 */
    舵机_全部中位();

    switch (稳定罗马)
    {
        case 1U:  return 'A';           /* I   -> A 点 */
        case 3U:  return 'B';           /* III -> B 点 */
        case 5U:  return 'C';           /* V   -> C 点 */
        case 7U:  return 'D';           /* VII -> D 点 */
        default:  return 0U;
    }
}

/**
  * @brief  出库上赛道：直行到刚压上 BC 黑线，再原地转 90° 摆到沿边方向
  * @param  往B走 1 = 朝 B（左转），0 = 朝 C（右转）
  */
static void 任务三_出库(uint8_t 往B走)
{
    uint32_t 出发时刻 = HAL_GetTick();

    电机_设置双轮(任务三_出库速度, 任务三_出库速度);

    while ((巡线_读取第几路(1) < 任务三_触线阈值)
        && (巡线_读取第几路(2) < 任务三_触线阈值)
        && (巡线_读取第几路(3) < 任务三_触线阈值)
        && ((uint32_t)(HAL_GetTick() - 出发时刻) < 任务三_出库超时毫秒))
    {
        /* 等压线 */
    }

    电机_全部停止();
    HAL_Delay(100U);

    if (往B走 != 0U) {
        左转();
    } else {
        右转();
    }
}

/* ============================== 公开接口 =================================== */

void 任务三_定点停车(void)
{
    uint8_t 目标点;
    uint8_t 往B走;          /* 1 = 朝 B（图上方），0 = 朝 C（图下方） */
    uint8_t 拐角数;         /* 还要走过几个拐角才停 */

    电机_全部停止();
    HAL_Delay(500U);

    /* ---- 1. 读卡片（OLED 实时显示 + 稳定检测） ---- */
    目标点 = 任务三_读卡片();

    if (目标点 == 0U) {
        return;
    }

    /* ---- 2. 卡片 -> 出发方向 + 要过的拐角数 ---- */
    if ((目标点 == 'A') || (目标点 == 'B'))
    {
        往B走  = 1U;
        拐角数 = (目标点 == 'B') ? 1U : 2U;
    }
    else
    {
        往B走  = 0U;
        拐角数 = (目标点 == 'C') ? 1U : 2U;
    }

    /* ---- 3. 出库，把车摆到 BC 边上 ---- */
    任务三_出库(往B走);

    /* ---- 4. 沿边巡线，数拐角；到第 拐角数 个拐角就停 ---- */
    while (拐角数 > 0U)
    {
        巡线(任务三_巡线速度);

        拐角数--;

        if (拐角数 > 0U)
        {
            if (往B走 != 0U) {
                左转();
            } else {
                右转();
            }
        }
    }

    电机_全部停止();
}