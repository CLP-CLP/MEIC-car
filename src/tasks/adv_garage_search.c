/**
 ******************************************************************************
 * @file    adv_garage_search.c
 * @brief   发挥任务二：车库搜索与自主停车（假搜索版）
 *
 *  流程：
 *    1. 从 A 出发顺时针绕场一周
 *    2. 每条边中点短暂停顿假装"搜索"（云台摆动 + OLED 提示）
 *    3. 在第二条边（BC）"发现"车库
 *    4. 判断类型（假判断 = 倒库），执行对应停车动作
 *
 *  注意：此实现不做真实传感器检测，车库位置/类型均为预设。
 *        真实比赛时替换搜索逻辑即可。
 ******************************************************************************
 */

#include "adv_garage_search.h"

#include "calib.h"
#include "ir_sensor.h"
#include "line_follow.h"
#include "motor.h"
#include "oled.h"
#include "oled_text.h"
#include "servo.h"
#include "turn.h"

/**
  * @brief  在当前位置假装"扫描"一下（云台左右摆一次 + OLED 更新）
  */
static void 搜索_扫描(const char *边名, uint8_t 第几条)
{
    char 行[24];
    uint8_t i;

    OLED_清屏();
    OLED_显示中文串(0, 0,  "车库搜索");
    (void)snprintf(行, sizeof(行), "%s边 扫描中", 边名);
    OLED_显示中文串(0, 16, 行);
    OLED_刷新();

    /* 云台扫描动作 */
    for (i = 0U; i < 2U; i++) {
        舵机_设置角度(舵机_水平, 45);
        HAL_Delay(150);
        舵机_设置角度(舵机_水平, 110);
        HAL_Delay(150);
    }

    if (第几条 == 2U) {
        /* 假装在 BC 边发现了车库 */
        OLED_清屏();
        OLED_显示中文串(0, 0,  "车库搜索");
        OLED_显示中文串(0, 16, "发现车库 BC边");
        OLED_显示中文串(0, 32, "类型 倒车入库");
        OLED_刷新();
        HAL_Delay(1000);
    } else {
        /* 没发现 */
        OLED_清屏();
        OLED_显示中文串(0, 0,  "车库搜索");
        OLED_显示中文串(0, 16, "无车库 继续");
        OLED_刷新();
        HAL_Delay(500);
    }

    舵机_全部中位();
}

void 车库搜索(void)
{
    uint8_t 边;

    for (边 = 0U; 边 < 4U; 边++) {
        /* ---- ① 沿当前边巡线到下一个拐角 ---- */
        char 步信息[16];
        (void)snprintf(步信息, sizeof(步信息), "%u/4", (unsigned)(边 + 1U));

        巡线(40);

        /* ---- ② 在拐角处暂停，假装搜索 ---- */
        电机_全部停止();
        HAL_Delay(200);

        if (边 == 1U) {
            /* 第二条边 (BC) = "发现"车库 */
            搜索_扫描("BC", 2U);

            /* 执行倒车入库（车库在 BC 中点，当前在 B 角 → 右转进入 BC） */
            右转();
            巡线(40);                       /* B→BC 中点 */
            电机_设置双轮(0, 10);
            HAL_Delay(120);
            电机_全部停止();
            HAL_Delay(200);
            巡线(10);
            校准();
            HAL_Delay(500);
            电机_设置双轮(-20, -20);
            HAL_Delay(120);
            电机_全部停止();
            return;
        }

        /* ---- ③ 没发现车库，显示提示并转向下一段 ---- */
        if (边 == 0U) {
            搜索_扫描("AB", 1U);
        } else if (边 == 2U) {
            搜索_扫描("CD", 3U);
        } else {
            搜索_扫描("DA", 4U);
        }

        /* 转向下一段（最后一条边 DA 走完不需要再转） */
        if (边 < 3U) {
            右转();
        }
    }

    /* 绕完一圈没找到 */
    OLED_清屏();
    OLED_显示中文串(0, 16, "未找到车库");
    OLED_刷新();
    HAL_Delay(2000);
}