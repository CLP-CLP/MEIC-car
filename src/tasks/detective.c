/**
 ******************************************************************************
 * @file    detective.c
 * @brief   自定义任务：巡线到横线，按耗时分辨车库类型
 *
 *  沿边巡线到车库门口 -> 用标定好的时间做最近邻匹配，
 *  分辨是 40 cm 车库（倒库）还是 25 cm 车库（侧方）。
 ******************************************************************************
 */

/* Includes ------------------------------------------------------------------*/
#include "detective.h"

#include "calib.h"
#include "garage_calib.h"       /* 侦探_走到横线() */
#include "gray_calib.h"         /* 灰度_取车库时间() */
#include "ir_sensor.h"
#include "line_follow.h"
#include "motor.h"
#include "park_back.h"          /* 倒库() / 侧方停车() */
#include "servo.h"
#include "turn.h"
#include <stdio.h>

#define 检测_蹭线阈值       600     /* 中间三路大于这个值就算压上横线（与侦探_蹭线阈值一致） */

void detective(void)
{
   舵机_设置角度(舵机_水平, 135);
   HAL_Delay(3000U);
   舵机_设置角度(舵机_水平, 35);
   HAL_Delay(3000U);
uint16_t 车库40毫秒 = 0U;
    uint16_t 车库25毫秒 = 0U;
    int      经过时间;
    int      差40;
    int      差25;
    uint8_t  已标定;

    HAL_Delay(2000U);

    /* ---- 沿边巡线到车库门口（逻辑与 侦探_走到横线() 完全一致） ---- */
    while (1) {
        巡线(巡线_默认速度);              /* 与标定时 侦探_走到横线() 的速度一致 */

        电机_设置双轮(10, 10);              /* 往前蹭，探头压横线 */
        HAL_Delay(200);
        电机_全部停止();
        HAL_Delay(1000);

        if (巡线_读取第几路(1) > 检测_蹭线阈值
         || 巡线_读取第几路(2) > 检测_蹭线阈值
         || 巡线_读取第几路(3) > 检测_蹭线阈值) {
           break;    // continue;                         /* 到车库门口了 */
        }
       // else {
      //      break;                            /* 不是这个路口，继续走 */
      //  }

        左转();                              /* 不是这个路口，继续走 */
    }

    /* ---- 尺子段：巡线(10)，与标定时完全一致 ---- */
    经过时间 = 巡线(10);

    /* ---- 用 Flash 标定值做最近邻匹配（与 detective() 逻辑一致） ---- */
    已标定 = 灰度_取车库时间(&车库40毫秒, &车库25毫秒);

    if (已标定 != 0U) {
        差40 = (经过时间 > (int)车库40毫秒) ? (经过时间 - (int)车库40毫秒)
                                            : ((int)车库40毫秒 - 经过时间);
        差25 = (经过时间 > (int)车库25毫秒) ? (经过时间 - (int)车库25毫秒)
                                            : ((int)车库25毫秒 - 经过时间);

        if (差40 <= 差25) {
            /* 40 cm 车库 -> 倒车入库 */
            电机_全部停止();
            HAL_Delay(200);
            校准();
            HAL_Delay(500);
            电机_设置双轮(-20, -20);
            HAL_Delay(120);
            电机_全部停止();
            电机_设置双轮(10, -10);
            HAL_Delay(550);
            电机_全部停止();    
        } else {
            /* 25 cm 车库 -> 侧方停车 */
            电机_全部停止();
            HAL_Delay(200);
            校准();
            HAL_Delay(500);
            电机_设置双轮(-20, -20);
            HAL_Delay(120);
            电机_全部停止();
        }
    } else {
        /* 还没做过车库时间标定，退回经验阈值兜底 */
        if (经过时间 > 1300) {
            电机_全部停止();
            HAL_Delay(200);
            校准();
            HAL_Delay(500);
            电机_设置双轮(-20, -20);
            HAL_Delay(120);
            电机_全部停止();
        } else {
            电机_全部停止();
            HAL_Delay(200);
            校准();
            HAL_Delay(500);
            电机_设置双轮(20, 20);
            HAL_Delay(120);
            电机_全部停止();
        }
    }
}