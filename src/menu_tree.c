/**
 ******************************************************************************
 * @file    menu_tree.c
 * @brief   菜单定义：菜单树 + 动作函数（引擎在 menu.c）
 *
 *  ─────────────────────────────────────────────────────────────────────
 *  为什么单独一个文件
 *      menu.c       纯引擎：三键导航、滚动、反白高亮、进栈出栈
 *      menu_tree.c  菜单定义：树长什么样、每一项干什么   ← 本文件
 *      想增/删/改菜单项，只改本文件，引擎一个字都不用动。
 *
 *  ─────────────────────────────────────────────────────────────────────
 *  怎么加菜单项（三步）
 *
 *   1) 写动作函数
 *          static void 动作_跑一圈(void) {
 *              菜单_提示("跑一圈", 600U);
 *              巡线(40);
 *              电机_全部停止();
 *          }
 *
 *   2) 如果要加新子菜单表，先在顶部"前向声明"区加一行：
 *          static const 菜单项 菜单_新表[];
 *
 *   3) 在对应菜单表里加一行
 *          菜单_命令("跑一圈", 动作_跑一圈),
 *
 *   表最后必须有 菜单_结束，否则引擎会一直往后读。
 *
 *  ─────────────────────────────────────────────────────────────────────
 *  前向声明：子菜单表可以写在**任何位置**，不再有顺序要求。
 *  新增子菜单表时，在这里加一行声明即可。
 *
 *  ─────────────────────────────────────────────────────────────────────
 *  菜单结构
 *      主菜单
 *        ├── 任务
 *        │     └── 巡线 / 循环 / 倒车入库 / 侧方停车 / 定点停车 / 检测停车 / 侦探
 *        ├── 调试
 *        │     ├── 巡线传感器读数
 *        │     ├── 灰度校准
 *        │     ├── 车库时间标定
 *        │     ├── 舵机调试
 *        │     └── 认卡测试
 *        ├── 控制
 *        │     └── 电机
 *        │           ├── 左电机速度
 *        │           └── 右电机速度
 *        └── 高级设置
 *              ├── 设置最低PWM
 *              └── 直接设置四路阈值
 ******************************************************************************
 */

/* Includes ------------------------------------------------------------------*/
#include "main.h"
#include "menu.h"
#include "button.h"
#include "oled.h"
#include "oled_text.h"
#include "tasks.h"

#include "gray_calib.h"
#include "ir_sensor.h"
#include "line_follow.h"
#include "proto.h"                      /* 协议_取卡面 / 协议_取颜色 / 协议_取形状 */
#include "motor.h"
#include "my_follow.h"
#include "servo.h"                  /* 云台舵机调试页 */
#include "turn.h"

#include <stdio.h>

/* ======================== 前向声明：消除顺序依赖 ========================== */
/*  新增子菜单表时，在这里加一行声明，表本身可以写在文件任意位置 */

static const 菜单项 菜单_任务[];
static const 菜单项 菜单_调试[];
static const 菜单项 菜单_控制[];
static const 菜单项 菜单_电机[];
static const 菜单项 菜单_舵机[];
static const 菜单项 菜单_高级设置[];

static void 执行_巡线(void);
static void 执行_循环(void);
static void 执行_倒车入库(void);
static void 执行_侧方停车(void);
static void 执行_定点停车(void);
static void 执行_检测停车(void);
static void 执行_侦探(void);

/* ========================== 主屏幕全局状态 ================================ */
/*  由各任务动作函数在执行前后更新，主屏幕读取并显示 */

static const char *主屏_任务名 = "";
static char        主屏_步信息[16] = "";
static 菜单_任务执行器 待执行任务 = NULL;

/* ====================== 主屏幕绘图（单帧，不循环） ======================== */
/*
 *  绘制一帧仪表板：五路传感器方块 + 电机转速条 + 任务信息
 *  由 显示_主屏幕() 循环调用，也可在任务运行前单独调用一帧
 */

/* ---- 跑车时的屏幕刷新预算 ------------------------------------------------ */
/*
 *  一帧 1024 字节走软件 I2C，整帧发完要 20~30 ms。以前是"每 100 ms 一口气
 *  发完"，也就是说车每 100 ms 就有 20~30 ms 既不看传感器也不发指令，
 *  正好在路口那一下被蒙住 —— 这就是"冲过路口"最主要的来源。
 *
 *  现在改成"细水长流"：每次巡线回环只发 主屏_刷新分片字节 个字节就走，
 *  一帧拆成几十次发完。总 CPU 占用不变，但最长一次蒙眼 < 1 ms。
 */
#define 主屏_运行刷新毫秒   100U    /* 跑车时每多少毫秒重新画一帧（0 = 不刷） */
#define 主屏_刷新分片字节   32U     /* 一次调用最多往 OLED 发多少字节 */

/** 1 = 上一帧还没送完，正在分片续传 */
static uint8_t  主屏_分片忙   = 0U;
/** 上一帧开始送的时刻（用来限速） */
static uint32_t 主屏_上次刷新 = 0U;

/**
  * @brief  只把主屏幕内容画进显存，不往 OLED 送（纳秒~百微秒级）
  */
static void 主屏_绘制(void)
{
    uint8_t  i;
    int16_t  x0, 填充宽, 总宽;
    char     行[24];

    OLED_清屏();

    /* ---- 五路传感器：抖动灰阶，不是黑白两态 ----
       原来的画法是"超过阈值就整个涂白，否则只画个空框"，只能看出压没压线；
       现在把每一路的**黑度**（0~1000，见 灰度_黑度千分）当灰度铺进框里：

           白底        -> 框里几乎全暗（淡）
           慢慢压上线  -> 框里的点越来越密，像铅笔越描越浓
           压住黑线    -> 框里几乎全亮
           正好 500    -> 一半的像素点亮 = 判黑阈值

       所以"框里比一半亮"就是压线，离阈值还差多少也一眼看得出来，
       比原来那个非黑即白的方块细得多。 */
    for (i = 0U; i < 巡线_路数; i++) {
        uint8_t  路 = 巡线_路数 - 1U - i;
        uint16_t 原始值 = 巡线_读取第几路(路);
        uint16_t 黑度   = 灰度_黑度千分(路, 原始值);

        x0 = (int16_t)(6 + i * 24);

        /* 框内（留 1 像素边框）铺灰阶 */
        OLED_填充灰阶矩形((int16_t)(x0 + 1), 3, (int16_t)(x0 + 18), 14, 黑度);

        /* 外框；判为压线时再套一圈内框加粗，保留原来的二值提示 */
        OLED_画矩形(x0, 2, (int16_t)(x0 + 19), 15, OLED_亮);
        if (巡线_是否压线(原始值, 灰度_各路阈值[路])) {
            OLED_画矩形((int16_t)(x0 + 1), 3, (int16_t)(x0 + 18), 14, OLED_亮);
        }
    }

    总宽 = 52;

    OLED_显示ASCII串(2,  20, "L");
    OLED_画矩形(8, 24, (int16_t)(8 + 总宽), 33, OLED_亮);
    填充宽 = (int16_t)((int32_t)总宽 * (int32_t)(电机_最后左速度 < 0 ? -电机_最后左速度 : 电机_最后左速度) / 100);
    if (填充宽 > 0) {
        OLED_填充矩形(8, 24, (int16_t)(8 + 填充宽), 33, OLED_亮);
    }
    (void)snprintf(行, sizeof(行), "%3d%%", (int)电机_最后左速度);
    OLED_显示ASCII串(8, 35, 行);

    OLED_显示ASCII串(64, 20, "R");
    OLED_画矩形(68, 24, (int16_t)(68 + 总宽), 33, OLED_亮);
    填充宽 = (int16_t)((int32_t)总宽 * (int32_t)(电机_最后右速度 < 0 ? -电机_最后右速度 : 电机_最后右速度) / 100);
    if (填充宽 > 0) {
        OLED_填充矩形(68, 24, (int16_t)(68 + 填充宽), 33, OLED_亮);
    }
    (void)snprintf(行, sizeof(行), "%3d%%", (int)电机_最后右速度);
    OLED_显示ASCII串(68, 35, 行);

    if (主屏_任务名[0] != '\0') {
        (void)snprintf(行, sizeof(行), "%s %s", 主屏_任务名, 主屏_步信息);
        OLED_显示中文串(2, 48, 行);
    } else {
        OLED_显示中文串(2, 48, 文本_主屏幕);
    }
}

void 主屏幕_画一帧(void)
{
    主屏_绘制();
    OLED_刷新();

    /* 整帧已经一次性送完，分片状态作废 */
    主屏_分片忙 = 0U;
}

void 主屏幕_画一帧分片(void)
{
    uint32_t 现在 = HAL_GetTick();

    /* 上一帧送完了，才考虑开新的一帧；并且按 主屏_运行刷新毫秒 限速 */
    if (主屏_分片忙 == 0U)
    {
        if ((uint32_t)(现在 - 主屏_上次刷新) < 主屏_运行刷新毫秒) {
            return;                     /* 还没到下次重画的时间，这一轮什么都不做 */
        }

        主屏_上次刷新 = 现在;
        主屏_绘制();                    /* 只写显存 */
        显示_开始刷新();                /* 打好窗口，准备一点一点发 */
        主屏_分片忙 = 1U;
    }

    /* 接着发一片。发完（返回 1）就等下一次重画 */
    if (显示_刷新分片(主屏_刷新分片字节) != 0U) {
        主屏_分片忙 = 0U;
    }
}

/* ====================== 主屏幕：实时状态仪表板 ============================ */
/*
 *  循环刷新传感器 + 电机转速 + 任务信息，按任意键退出。
 *  同时也作为菜单"主屏幕"菜单项的动作函数。
 *  注意：不在这里调用 菜单_运行()，菜单循环由 main.c 统一管理。
 */

void 显示_主屏幕(void)
{
    for (;;) {
        主屏幕_画一帧();
        if (按键_取事件() != BTN_NONE) { break; }
        HAL_Delay(80U);
    }
}

/* ============================== 动作函数 =================================== */
/*
 *  动作函数分两类：
 *     "选择器"（动作_xxx）：供菜单调用，只负责设置任务状态 + 请求退出菜单
 *     "执行器"（执行_xxx）：供 main.c 在主屏幕上下文里调用，真正跑任务
 */

/* -------------------------------------------------------------------- */
/*  任务类                                                              */
/* -------------------------------------------------------------------- */

static void 动作_巡线(void)
{
    主屏_任务名 = 文本_巡线;
    (void)snprintf(主屏_步信息, sizeof(主屏_步信息), "1/1");
    待执行任务 = 执行_巡线;
    菜单_请求退出();
}

static void 执行_巡线(void)
{
    巡线_每帧回调 = 主屏幕_画一帧分片;
    巡线(40);
    巡线_每帧回调 = NULL;
    电机_全部停止();
    主屏_任务名 = "已完成";
    (void)snprintf(主屏_步信息, sizeof(主屏_步信息), "%s", 文本_巡线);
}

static void 动作_循环(void)
{
    主屏_任务名 = 文本_循环;
    (void)snprintf(主屏_步信息, sizeof(主屏_步信息), "1/4");
    待执行任务 = 执行_循环;
    菜单_请求退出();
}

static void 执行_循环(void)
{
    uint8_t 边;

    巡线_每帧回调 = 主屏幕_画一帧分片;
    转向_每帧回调 = 主屏幕_画一帧;
    for (边 = 0U; 边 < 4U; 边++) {
        (void)snprintf(主屏_步信息, sizeof(主屏_步信息), "%u/4", (unsigned)(边 + 1U));
        主屏幕_画一帧();
        巡线(40);
        电机_全部停止();
        HAL_Delay(200U);
        if (边 < 3U) { 左转(); }
    }
    巡线_每帧回调 = NULL;
    转向_每帧回调 = NULL;
    主屏_任务名 = "已完成";
    (void)snprintf(主屏_步信息, sizeof(主屏_步信息), "%s", 文本_循环);
}

static void 动作_倒车入库(void)
{
    主屏_任务名 = 文本_倒车入库;
    (void)snprintf(主屏_步信息, sizeof(主屏_步信息), "1/1");
    待执行任务 = 执行_倒车入库;
    菜单_请求退出();
}

static void 执行_倒车入库(void)
{
    巡线_每帧回调 = 主屏幕_画一帧分片;
    转向_每帧回调 = 主屏幕_画一帧;
    倒库();
    巡线_每帧回调 = NULL;
    转向_每帧回调 = NULL;
    主屏_任务名 = "已完成";
    (void)snprintf(主屏_步信息, sizeof(主屏_步信息), "%s", 文本_倒车入库);
}

static void 动作_侧方停车(void)
{
    主屏_任务名 = 文本_侧方停车;
    (void)snprintf(主屏_步信息, sizeof(主屏_步信息), "1/1");
    待执行任务 = 执行_侧方停车;
    菜单_请求退出();
}

static void 执行_侧方停车(void)
{
    巡线_每帧回调 = 主屏幕_画一帧分片;
    转向_每帧回调 = 主屏幕_画一帧;
    侧方停车();
    巡线_每帧回调 = NULL;
    转向_每帧回调 = NULL;
    主屏_任务名 = "已完成";
    (void)snprintf(主屏_步信息, sizeof(主屏_步信息), "%s", 文本_侧方停车);
}

static void 动作_定点停车(void)
{
    主屏_任务名 = 文本_定点停车;
    (void)snprintf(主屏_步信息, sizeof(主屏_步信息), "1/1");
    待执行任务 = 执行_定点停车;
    菜单_请求退出();
}

static void 执行_定点停车(void)
{
    巡线_每帧回调 = 主屏幕_画一帧分片;
    转向_每帧回调 = 主屏幕_画一帧;
    任务三_定点停车();
    巡线_每帧回调 = NULL;
    转向_每帧回调 = NULL;
    主屏_任务名 = "已完成";
    (void)snprintf(主屏_步信息, sizeof(主屏_步信息), "%s", 文本_定点停车);
}

static void 动作_检测停车(void)
{
    主屏_任务名 = 文本_检测停车;
    (void)snprintf(主屏_步信息, sizeof(主屏_步信息), "1/1");
    待执行任务 = 执行_检测停车;
    菜单_请求退出();
}

static void 执行_检测停车(void)
{
    巡线_每帧回调 = 主屏幕_画一帧分片;
    转向_每帧回调 = 主屏幕_画一帧;
    巡线检测停车();
    巡线_每帧回调 = NULL;
    转向_每帧回调 = NULL;
    主屏_任务名 = "已完成";
    (void)snprintf(主屏_步信息, sizeof(主屏_步信息), "%s", 文本_检测停车);
}

static void 动作_侦探(void)
{
    主屏_任务名 = 文本_侦探;
    (void)snprintf(主屏_步信息, sizeof(主屏_步信息), "1/1");
    待执行任务 = 执行_侦探;
    菜单_请求退出();
}

static void 执行_侦探(void)
{
    巡线_每帧回调 = 主屏幕_画一帧分片;
    转向_每帧回调 = 主屏幕_画一帧;
    detective();
    巡线_每帧回调 = NULL;
    转向_每帧回调 = NULL;
    主屏_任务名 = "已完成";
    (void)snprintf(主屏_步信息, sizeof(主屏_步信息), "%s", 文本_侦探);
}

/* -------------------------------------------------------------------- */
/*  云台调试：上下键调角度，确认键换舵机，长按退出                       */
/* -------------------------------------------------------------------- */

/** 每按一次上下键挪几度 */
#define 舵机调试_步进       5

static void 动作_舵机调试(void)
{
    char    行[20];
    uint8_t 选中 = 0U;

    for (;;)
    {
        uint8_t i;

        OLED_清屏();

        /* 标题栏反白；右上角标出正在调哪一路 */
        OLED_填充矩形(0, 0, OLED_宽 - 1, 15, OLED_亮);
        OLED_显示中文串色(2, 0, 文本_舵机调试, OLED_灭);
        (void)snprintf(行, sizeof(行), "S%u", (unsigned)(选中 + 1U));
        OLED_显示ASCII串色(112, 4, 行, OLED_灭);

        /* 两路的角度；选中那行套个框 */
        for (i = 0U; i < 舵机_数量; i++)
        {
            int16_t 行顶 = (int16_t)(16 + i * 16);

            if (i == 选中) {
                OLED_画矩形(0, 行顶, OLED_宽 - 1, (int16_t)(行顶 + 15), OLED_亮);
            }

            (void)snprintf(行, sizeof(行), "%u: %3d",
                           (unsigned)(i + 1U), (int)舵机_角度[i]);
            OLED_显示ASCII串(2, (int16_t)(行顶 + 4), 行);
        }

        OLED_显示中文串(2, 48, 文本_舵机提示);
        OLED_刷新();

        /* ---- 按键 ---- */
        {
            btn_event_t 事件 = 按键_取事件();

            if (事件 == BTN_UP) {
                舵机_设置角度((舵机_编号)选中, (int16_t)(舵机_角度[选中] + 舵机调试_步进));
            } else if (事件 == BTN_DOWN) {
                舵机_设置角度((舵机_编号)选中, (int16_t)(舵机_角度[选中] - 舵机调试_步进));
            } else if (事件 == BTN_SEL) {
                选中 = (uint8_t)((选中 + 1U) % 舵机_数量);      /* 换一路调 */
            } else if (事件 == BTN_BACK) {
                break;                                          /* 长按退出 */
            }
        }

        /* 刷一帧要 25 ms 左右，这里再歇一下就够了：按键状态机 1 ms 轮询一次
           也来得及，但没必要把 CPU 全烧在刷屏上 */
        HAL_Delay(20U);
    }

    /* 退出时把两个舵机留在中位，免得云台歪着 */
    舵机_全部中位();
}

/* -------------------------------------------------------------------- */
/*  传感器调试：五路巡线传感器实时读数，按任意键退出                     */
/* -------------------------------------------------------------------- */

static void 动作_原始值(void)
{
    char 行[20];

    for (;;) {
        uint8_t i;

        OLED_清屏();
        OLED_显示中文串(0, 0, 文本_原始值);
        for (i = 0U; i < 5U; i++) {
            uint16_t 原始值 = 巡线_读取第几路(i);
            int16_t  y      = (int16_t)(16 + i * 9);

            /* 左边留着原始数字：要看精确值就看这里 */
            (void)snprintf(行, sizeof(行), "c%u %4u", (unsigned)i, (unsigned)原始值);
            OLED_显示ASCII串(0, y, 行);

            /* 右边一条灰阶电平条：黑度越浓越亮，亮到一半就是判黑阈值，
               和主屏幕那五个框是同一套换算，两边对着看就能调阈值 */
            OLED_画矩形(60, y, 125, (int16_t)(y + 6), OLED_亮);
            OLED_填充灰阶矩形(61, (int16_t)(y + 1), 124, (int16_t)(y + 5),
                              灰度_黑度千分(i, 原始值));
        }
        OLED_刷新();

        if (按键_取事件() != BTN_NONE) { break; }
        HAL_Delay(120U);
    }
}

/* -------------------------------------------------------------------- */
/*  认卡测试：实时显示 OpenMV 传来的所有卡片信息                         */
/* -------------------------------------------------------------------- */

static void 动作_认卡测试(void)
{
    char 行[24];
    uint8_t 罗马;

    舵机_设置角度(舵机_垂直, 70);
    HAL_Delay(300U);

    for (;;)
    {
        罗马 = 协议_取卡面();

        OLED_清屏();

        /* 标题 */
        OLED_填充矩形(0, 0, OLED_宽 - 1, 15, OLED_亮);
        OLED_显示中文串色(2, 0, "认卡测试", OLED_灭);

        /* 罗马数字 */
        if (罗马 == 0U)
        {
            (void)snprintf(行, sizeof(行), "未识别");
        }
        else
        {
            switch (罗马)
            {
                case 1U:  (void)snprintf(行, sizeof(行), "I   -> A点"); break;
                case 3U:  (void)snprintf(行, sizeof(行), "III -> B点"); break;
                case 5U:  (void)snprintf(行, sizeof(行), "V   -> C点"); break;
                case 7U:  (void)snprintf(行, sizeof(行), "VII -> D点"); break;
                default:  (void)snprintf(行, sizeof(行), "未知 (%u)", (unsigned)罗马);
                          break;
            }
        }
        OLED_显示ASCII串(0, 30, 行);

        OLED_刷新();

        if (按键_取事件() != BTN_NONE) { break; }
        HAL_Delay(120U);
    }

    舵机_全部中位();
}

/* -------------------------------------------------------------------- */
/*  电机控制：按住上/下键连续增减，确认/返回键保存退出                   */
/* -------------------------------------------------------------------- */

static void 动作_设置左电机(void)
{
    int16_t 速度 = 灰度_左电机速度;
    char    行[20];

    for (;;) {
        OLED_清屏();
        OLED_显示中文串(0, 0, "左电机速度");
        (void)snprintf(行, sizeof(行), "%3d%%", (int)速度);
        OLED_显示ASCII串(46, 36, 行);
        OLED_刷新();

        电机_转速(电机_左, 速度);

        btn_event_t 事件 = 按键_取事件();
        if (事件 == BTN_SEL || 事件 == BTN_BACK) { break; }

        if (HAL_GPIO_ReadPin(BTN_PORT, BTN_UP_PIN) == GPIO_PIN_RESET && 速度 < 100) {
            速度++;
            灰度_左电机速度 = 速度;
        } else if (HAL_GPIO_ReadPin(BTN_PORT, BTN_DOWN_PIN) == GPIO_PIN_RESET && 速度 > 0) {
            速度--;
            灰度_左电机速度 = 速度;
        }
        HAL_Delay(20U);
    }
    电机_停止(电机_左);
    灰度_保存电机设置();
}

static void 动作_设置右电机(void)
{
    int16_t 速度 = 灰度_右电机速度;
    char    行[20];

    for (;;) {
        OLED_清屏();
        OLED_显示中文串(0, 0, "右电机速度");
        (void)snprintf(行, sizeof(行), "%3d%%", (int)速度);
        OLED_显示ASCII串(46, 36, 行);
        OLED_刷新();

        电机_转速(电机_右, 速度);

        btn_event_t 事件 = 按键_取事件();
        if (事件 == BTN_SEL || 事件 == BTN_BACK) { break; }

        if (HAL_GPIO_ReadPin(BTN_PORT, BTN_UP_PIN) == GPIO_PIN_RESET && 速度 < 100) {
            速度++;
            灰度_右电机速度 = 速度;
        } else if (HAL_GPIO_ReadPin(BTN_PORT, BTN_DOWN_PIN) == GPIO_PIN_RESET && 速度 > 0) {
            速度--;
            灰度_右电机速度 = 速度;
        }
        HAL_Delay(20U);
    }
    电机_停止(电机_右);
    灰度_保存电机设置();
}

/* -------------------------------------------------------------------- */
/*  舵机控制：按住上/下键连续增减角度，确认/返回键退出                     */
/* -------------------------------------------------------------------- */

static void 动作_设置舵机1(void)
{
    int16_t 角度 = 舵机_水平_中位角度;
    char    行[20];

    for (;;) {
        OLED_清屏();
        OLED_显示中文串(0, 0, "舵机1角度");
        (void)snprintf(行, sizeof(行), "%3d度", (int)角度);
        OLED_显示ASCII串(40, 36, 行);
        OLED_刷新();

        舵机_设置角度(舵机_水平, 角度);

        btn_event_t 事件 = 按键_取事件();
        if (事件 == BTN_SEL || 事件 == BTN_BACK) { break; }

        if (HAL_GPIO_ReadPin(BTN_PORT, BTN_UP_PIN) == GPIO_PIN_RESET && 角度 < 舵机_水平_最大角度) {
            角度++;
        } else if (HAL_GPIO_ReadPin(BTN_PORT, BTN_DOWN_PIN) == GPIO_PIN_RESET && 角度 > 舵机_水平_最小角度) {
            角度--;
        }
        HAL_Delay(20U);
    }
    /* 退出时回到中位 */
    舵机_设置角度(舵机_水平, 舵机_水平_中位角度);
}

static void 动作_设置舵机2(void)
{
    int16_t 角度 = 舵机_垂直_中位角度;
    char    行[20];

    for (;;) {
        OLED_清屏();
        OLED_显示中文串(0, 0, "舵机2角度");
        (void)snprintf(行, sizeof(行), "%3d度", (int)角度);
        OLED_显示ASCII串(40, 36, 行);
        OLED_刷新();

        舵机_设置角度(舵机_垂直, 角度);

        btn_event_t 事件 = 按键_取事件();
        if (事件 == BTN_SEL || 事件 == BTN_BACK) { break; }

        if (HAL_GPIO_ReadPin(BTN_PORT, BTN_UP_PIN) == GPIO_PIN_RESET && 角度 < 舵机_垂直_最大角度) {
            角度++;
        } else if (HAL_GPIO_ReadPin(BTN_PORT, BTN_DOWN_PIN) == GPIO_PIN_RESET && 角度 > 舵机_垂直_最小角度) {
            角度--;
        }
        HAL_Delay(20U);
    }
    /* 退出时回到中位 */
    舵机_设置角度(舵机_垂直, 舵机_垂直_中位角度);
}

/* -------------------------------------------------------------------- */
/*  高级设置                                                            */
/* -------------------------------------------------------------------- */

static void 动作_设置最低PWM(void)
{
    uint8_t 最低 = 灰度_最低PWM;
    char    行[20];

    for (;;) {
        OLED_清屏();
        OLED_显示中文串(0, 0, "设置最低PWM");
        (void)snprintf(行, sizeof(行), "%3u%%", (unsigned)最低);
        OLED_显示ASCII串(52, 36, 行);
        OLED_刷新();

        btn_event_t 事件 = 按键_取事件();
        if (事件 == BTN_SEL || 事件 == BTN_BACK) { break; }

        if (HAL_GPIO_ReadPin(BTN_PORT, BTN_UP_PIN) == GPIO_PIN_RESET && 最低 < 100U) {
            最低++;
            电机_设置最小占空比(最低);
            灰度_最低PWM = 最低;
        } else if (HAL_GPIO_ReadPin(BTN_PORT, BTN_DOWN_PIN) == GPIO_PIN_RESET && 最低 > 0U) {
            最低--;
            电机_设置最小占空比(最低);
            灰度_最低PWM = 最低;
        }
        HAL_Delay(20U);
    }
    灰度_保存电机设置();
}

/**
  * @brief  逐路设置灰度阈值：上/下调值，确认进下一路，五路设完自动保存
  */
static void 动作_直接设置四路阈值(void)
{
    uint16_t 值[巡线_路数];
    uint8_t  通道 = 0U;
    uint8_t  已修改 = 0U;
    char     行[20];
    uint8_t  i;

    for (i = 0U; i < 巡线_路数; i++) {
        值[i] = 灰度_各路阈值[i];
    }

    for (;;) {
        OLED_清屏();
        (void)snprintf(行, sizeof(行), "通道%u/5", (unsigned)(通道 + 1U));
        OLED_显示中文串(0, 0, 行);
        (void)snprintf(行, sizeof(行), "%4u", (unsigned)值[通道]);
        OLED_显示ASCII串(40, 36, 行);
        OLED_刷新();

        btn_event_t 事件 = 按键_取事件();
        if (事件 == BTN_SEL) {
            通道++;
            if (通道 >= 巡线_路数) { break; }
        } else if (事件 == BTN_BACK) {
            break;
        }

        if (HAL_GPIO_ReadPin(BTN_PORT, BTN_UP_PIN) == GPIO_PIN_RESET && 值[通道] < 4095U) {
            值[通道] += 10U;
            已修改 = 1U;
        } else if (HAL_GPIO_ReadPin(BTN_PORT, BTN_DOWN_PIN) == GPIO_PIN_RESET && 值[通道] >= 10U) {
            值[通道] -= 10U;
            已修改 = 1U;
        }
        HAL_Delay(30U);
    }

    if (已修改 != 0U) {
        for (i = 0U; i < 巡线_路数; i++) {
            灰度_各路阈值[i] = 值[i];
        }
    }
}

/* ============================== 菜单表 ===================================== */
/*
 *  前向声明已消除顺序依赖，子菜单表可以按任意顺序排列。
 *
 *  每个表的结构：
 *      菜单_返回()             ← 第一项固定是返回（主菜单没有）
 *      菜单_命令(标题, 动作)   ← 执行一个函数
 *      菜单_子菜单(标题, 表)   ← 进下一级
 *      菜单_结束               ← 必须有，否则引擎跑飞
 */

/* ---- 控制 > 电机 ---- */

static const 菜单项 菜单_电机[] =
{
    菜单_返回(),
    菜单_命令("左电机速度", 动作_设置左电机),
    菜单_命令("右电机速度", 动作_设置右电机),
    菜单_结束
};

/* ---- 控制 > 舵机 ---- */

static const 菜单项 菜单_舵机[] =
{
    菜单_返回(),
    菜单_命令("舵机1角度", 动作_设置舵机1),
    菜单_命令("舵机2角度", 动作_设置舵机2),
    菜单_结束
};

/* ---- 控制 ---- */

static const 菜单项 菜单_控制[] =
{
    菜单_返回(),
    菜单_子菜单("电机", 菜单_电机),
    菜单_子菜单("舵机", 菜单_舵机),
    菜单_结束
};

/* ---- 调试 ---- */

static const 菜单项 菜单_调试[] =
{
    菜单_返回(),
    菜单_命令("巡线传感器读数", 动作_原始值),
    菜单_命令("手动校准",       灰度_手动校准),
    菜单_命令("自动校准",       灰度_校准),
    菜单_命令("车库时间标定",   车库时间标定),
    菜单_命令(文本_舵机调试,    动作_舵机调试),
    菜单_命令("认卡测试",       动作_认卡测试),
    菜单_结束
};

/* ---- 任务 ---- */

static const 菜单项 菜单_任务[] =
{
    菜单_返回(),
    菜单_命令(文本_巡线,     动作_巡线),
    菜单_命令(文本_循环,     动作_循环),
    菜单_命令(文本_倒车入库, 动作_倒车入库),
    菜单_命令(文本_侧方停车, 动作_侧方停车),
    菜单_命令(文本_定点停车, 动作_定点停车),
    菜单_命令(文本_检测停车, 动作_检测停车),
    菜单_命令(文本_侦探,     动作_侦探),
    菜单_结束
};

/* ---- 高级设置 ---- */

static const 菜单项 菜单_高级设置[] =
{
    菜单_返回(),
    菜单_命令("设置最低PWM",     动作_设置最低PWM),
    菜单_命令("直接设置四路阈值", 动作_直接设置四路阈值),
    菜单_结束
};

/* ---- 主菜单 ---- */

static const 菜单项 菜单_主[] =
{
    菜单_命令(文本_主屏幕, 显示_主屏幕),
    菜单_子菜单("任务",     菜单_任务),
    菜单_子菜单("调试",     菜单_调试),
    菜单_子菜单("控制",     菜单_控制),
    菜单_子菜单("高级设置", 菜单_高级设置),
    菜单_结束
};

/* ============================== 给引擎的入口 =============================== */

const 菜单项 *菜单树_取主表(void)
{
    return 菜单_主;
}

const char *菜单树_取主标题(void)
{
    return 文本_主菜单;
}

/* ========================== 给 main.c 的接口 ============================== */

菜单_任务执行器 菜单树_取待执行任务(void)
{
    return 待执行任务;
}

void 菜单树_清待执行任务(void)
{
    待执行任务 = NULL;
}

const char *菜单树_取当前任务名(void)
{
    return 主屏_任务名;
}

const char *菜单树_取当前步信息(void)
{
    return 主屏_步信息;
}