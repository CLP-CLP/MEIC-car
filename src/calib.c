/**
 ******************************************************************************
 * @file    calib.c
 * @brief   巡线传感器校准 —— 空函数，等你自己填
 *
 *  背景
 *      巡线_黑线阈值 是 ir_sensor.h 里的编译期宏，运行时改不了。
 *      但 巡线_是否压线() 和 巡线_计算位置() 的阈值都是**入参**，
 *      所以你自己定义一个变量、校准完把值填进去，再传进去即可，
 *      完全不用动 ir_sensor 模块。
 ******************************************************************************
 */

/* Includes ------------------------------------------------------------------*/
#include "main.h"
#include "calib.h"
#include "ir_sensor.h"
#include "motor.h"
#include "gray_calib.h"     /* 每路阈值：灰度_各路阈值[i] */

#include <stdio.h>          /* 打印校准结果用，走 USB 虚拟串口 */

void 校准(void)
{
    /* ============================== 自己写 ==============================
     *
     *  典型做法：上电（或按键、串口命令）触发，让人把车分别放到
     *  白底和黑线上各读一遍，取中间值当阈值。
     *
     *      uint16_t 白底[巡线_路数];
     *      uint16_t 黑线[巡线_路数];
     *      巡线_读数 读数;
     *      uint8_t i;
     *
     *      printf("请把车放到白底上，2 秒后采样...\r\n");
     *      HAL_Delay(2000);
     *      巡线_读取全部(&读数);
     *      for (i = 0; i < 巡线_路数; i++) { 白底[i] = 读数.原始值[i]; }
     *
     *      printf("请把车放到黑线上，2 秒后采样...\r\n");
     *      HAL_Delay(2000);
     *      巡线_读取全部(&读数);
     *      for (i = 0; i < 巡线_路数; i++) { 黑线[i] = 读数.原始值[i]; }
     *
     *      for (i = 0; i < 巡线_路数; i++) {
     *          printf("第 %u 路: 白 %4u  黑 %4u  阈值 %4u\r\n",
     *                 i, 白底[i], 黑线[i], (白底[i] + 黑线[i]) / 2);
     *      }
     *
     *  结果怎么用：在你自己的文件里定义阈值变量，传给这两个函数
     *      uint16_t 我的阈值;
     *      巡线_计算位置(&读数, 我的阈值);
     *      巡线_是否压线(读数.原始值[i], 我的阈值);
     *
     *  什么时候可以阻塞
     *      校准需要人手动挪车，所以这里用 HAL_Delay() 是合适的；
     *      但千万别在 巡线() 里这么做。
     * ================================================================== */

/*
     *  倒车入库校准：在路口将车身从"与线平行"旋转到"与线垂直"。
     *
     *  初始状态（路口）：中间3路压线（黑），第0路、第4路在白区。
     *  目标：旋转约90度，使第0路和第4路同时压线 = 线横穿车底。
     *
     *  三阶段：
     *    1. 粗转：朝一个方向持续旋转，直到第0路碰到黑线
     *    2. 反向找：反向旋转直到第4路也碰到黑线
     *    3. 脉冲精调：两端有任一端离线就微调，脉冲式防冲过头
     */




    const uint32_t 超时 = 4000;
    //const uint32_t 脉冲宽度 = 30;
    //const uint32_t 脉冲间隔 = 80;
    while (1) {
        电机_全部停止();
        while(1) {
                uint16_t 读数 = 巡线_读取第几路(4);
                if(读数 < 灰度_各路强阈值[4]) {
                    break;
                }
                电机_设置双轮(0, -20);
            
            电机_全部停止();
        }

        while(1) {
                uint16_t 读数 = 巡线_读取第几路(0);
                if(读数 < 灰度_各路强阈值[0]) {
                    break;
                }
                电机_设置双轮(-10, 0);
            
            电机_全部停止();
        }
  
  
  
  
  
  
    }






}