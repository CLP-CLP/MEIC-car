/**
  ******************************************************************************
  * @file    servo.c
  * @brief   两路舵机 PWM 输出（PB8 = TIM4_CH3 / PB9 = TIM4_CH4）+ 慢转（斜坡）
  *
  *  ── 怎么产生 50 Hz ──
  *      TIM4 挂在 APB1 上，本工程 APB1 预分频 = 2，所以定时器时钟 = 72 MHz
  *      （APB1 分频不为 1 时，定时器时钟自动 ×2）。
  *
  *          预分频 71  ->  72 MHz / 72 = 1 MHz，一格 1 µs
  *          自动重装 19999 -> 20000 格 = 20 ms = 50 Hz
  *
  *      于是比较值 CCR 直接就是"高电平多少微秒"，不用再做任何换算：
  *          CCR = 500   -> 0.5 ms  -> 0°
  *          CCR = 1500  -> 1.5 ms  -> 90°（中位）
  *          CCR = 2500  -> 2.5 ms  -> 180°
  *
  *  ── 怎么让舵机慢慢转（本文件的核心）──
  *      舵机能"看到"新位置的时机只有每个 20 ms 周期的开头：PWM 周期一过，
  *      它就按新的高电平宽度去走。所以想让它慢慢来，只要**每个周期只把
  *      CCR 挪一点点**即可，挪多了它就甩得快，挪少了它就慢。
  *
  *      实现分三步：
  *       1) 舵机_设置角度() 只把目标脉宽记到 舵机_目标_脉冲_Q4[]，立刻返回；
  *       2) TIM4 的更新中断（每个周期末尾进一次）里，把 舵机_当_脉冲_Q4[]
  *          朝目标挪一小步（舵机_每拍步进_Q4），再写进 CCR；
  *       3) 追上目标就停，中断里不再写 CCR —— 不转的时候一点开销都没有。
  *
  *      为什么用 1/16 µs 当单位（Q4 定标）：
  *          60 度/秒 折合每 20 ms 只走 13.3 µs，用整微秒存会四舍五入成 13，
  *          慢速档（比如 10 度/秒，每拍 2.2 µs）就会走样。留 4 位小数，
  *          最慢能稳到 1.4 度/秒左右，慢速档也走得匀。
  *
  *      为什么 CCR 写进去要等到下一个周期才生效：
  *          HAL 配 PWM 时开了 CCR 预装载（OCxPE），写 CCR 只是写进影子寄存器，
  *          下一个更新事件才搬到真正起作用的寄存器。好处是绝不会在脉冲中途
  *          改宽度（那样会出来一个畸形的窄/宽脉冲，舵机要抖一下）。
  *
  *  ── 为什么不用电机那个 TIM3 ──
  *      电机 PWM 是 20 kHz（为了不啸叫），舵机要 50 Hz，差 400 倍，
  *      一个定时器没法同时出这两种频率（改 ARR 会让电机的频率也变）。
  *
  *  ⚠ 本文件使用中文标识符（UTF-8），需要 GCC 10 及以上。
  *     凡是以 HAL_ 开头的固定接口名一律保持英文。
  ******************************************************************************
  */

/* Includes ------------------------------------------------------------------*/
#include "main.h"
#include "servo.h"

/* ============================== 私有数据 =================================== */

/** TIM4 句柄（本模块私有） */
static TIM_HandleTypeDef 舵机_定时器;

/** 两路对应的定时器通道，下标 = 舵机_编号 */
static const uint32_t 舵机_通道表[舵机_数量] =
{
    舵机_水平_通道,
    舵机_垂直_通道,
};

/** 当前角度（目标），供菜单/调试页显示 */
int16_t 舵机_角度[舵机_数量] = { 舵机_水平_中位角度, 舵机_垂直_中位角度 };

/** 实际角度（舵机现在真正在的位置），由 20 ms 中断刷新 */
volatile int16_t 舵机_实际角度[舵机_数量] = { 舵机_水平_中位角度, 舵机_垂直_中位角度 };

/**
  * @brief 当前输出的脉宽，单位 1/16 µs（Q4）
  * @note  只在本文件里用；主循环改目标、中断改这个，两边都要看得见，故 volatile
  */
static volatile uint32_t 舵机_当_脉冲_Q4[舵机_数量];

/** 目标脉宽，单位 1/16 µs（Q4）—— 舵机_设置角度() 写，20 ms 中断读 */
static volatile uint32_t 舵机_目标_脉冲_Q4[舵机_数量];

/**
  * @brief 每 20 ms 走多少，单位 1/16 µs（Q4）
  * @note  60 度/秒 -> 213（≈13.3 µs/拍）。由 舵机_设置速度() 按度/秒换算出来
  */
static volatile uint32_t 舵机_每拍步进_Q4 = 213U;

/** 当前设定的角速度（度/秒），只给 舵机_读取速度() 用 */
static int16_t 舵机_当前速度 = 舵机_默认速度;

/* ============================== 私有函数 =================================== */

/**
  * @brief  把角度夹到该路的机械范围，并换算成脉宽（µs）
  * @param  哪台    舵机编号（调用方保证已经检查过范围）
  * @param  角度    输入输出：超范围时会被夹住，夹完的值写回这里
  * @retval 对应的脉宽（µs），一定落在 舵机_最小脉宽 ~ 舵机_最大脉宽 之间
  */
static uint16_t 舵机_换算脉宽(舵机_编号 哪台, int16_t *角度)
{
    int16_t 最小, 最大;

    /* 每路舵机有不同的物理限位，先夹到允许范围内 */
    if (哪台 == 舵机_水平) {
        最小 = 舵机_水平_最小角度;
        最大 = 舵机_水平_最大角度;
    } else {
        最小 = 舵机_垂直_最小角度;
        最大 = 舵机_垂直_最大角度;
    }

    if (*角度 < 最小) { *角度 = 最小; }
    if (*角度 > 最大) { *角度 = 最大; }

    /* 分子加半个角度做四舍五入：35° 理论上是 888.9 µs，取 889 而不是 888，
       这样 35° -> 889 µs -> 反算回来还是 35°，不会一上来就显示 34° */
    return (uint16_t)(舵机_最小脉宽
                    + (((uint32_t)(*角度) * (舵机_最大脉宽 - 舵机_最小脉宽))
                       + (uint32_t)舵机_角度上限 / 2U)
                      / (uint32_t)舵机_角度上限);
}

/**
  * @brief  把"当前脉宽"真正写到 CCR，同时刷新 舵机_实际角度[]
  * @note   只有这一步会碰硬件，所以慢转和"立即到位"最后都汇到这里
  */
static void 舵机_输出(舵机_编号 哪台)
{
    uint32_t 脉宽 = (舵机_当_脉冲_Q4[哪台] + 8U) / 16U;     /* Q4 -> µs，四舍五入 */

    __HAL_TIM_SET_COMPARE(&舵机_定时器, 舵机_通道表[哪台], 脉宽);

    /* 角度按当前标定反算一下，别让显示和实际对不上
       （用别的脉宽范围跑 270° 舵机时，这里算出来的"度"就只是参考值） */
    舵机_实际角度[哪台] = (int16_t)(((uint32_t)(脉宽 - 舵机_最小脉宽) * 舵机_角度上限)
                                  / (舵机_最大脉宽 - 舵机_最小脉宽));
}

/**
  * @brief  每 20 ms 走一小步（在 TIM4 更新中断里调用）
  * @note   两路各自判断，已经到位的直接跳过 —— 不动的时候不占中断时间
  */
static void 舵机_走一小步(void)
{
    uint32_t i;

    for (i = 0U; i < 舵机_数量; i++)
    {
        uint32_t 现   = 舵机_当_脉冲_Q4[i];
        uint32_t 目标 = 舵机_目标_脉冲_Q4[i];
        uint32_t 步   = 舵机_每拍步进_Q4;

        if (现 == 目标) {
            continue;                       /* 已经到位，这一拍什么都不做 */
        }

        if (步 == 0U) {
            步 = 1U;                        /* 兜底：再慢也得往前走一格 */
        }

        if (现 < 目标) {
            现 += 步;
            if (现 > 目标) { 现 = 目标; }    /* 别冲过头 */
        } else {
            if (现 > 目标 + 步) {
                现 -= 步;
            } else {
                现 = 目标;
            }
        }

        舵机_当_脉冲_Q4[i] = 现;
        舵机_输出((舵机_编号)i);
    }
}

/* ============================== 函数实现 =================================== */

void 舵机_初始化(void)
{
    TIM_OC_InitTypeDef 输出比较 = {0};

    舵机_定时器.Instance               = 舵机_定时器编号;
    舵机_定时器.Init.Prescaler         = 舵机_预分频;
    舵机_定时器.Init.CounterMode       = TIM_COUNTERMODE_UP;
    舵机_定时器.Init.Period            = 舵机_自动重装值;
    舵机_定时器.Init.ClockDivision     = TIM_CLOCKDIVISION_DIV1;
    舵机_定时器.Init.AutoReloadPreload = TIM_AUTORELOAD_PRELOAD_DISABLE;

    /* HAL_TIM_PWM_Init() 内部会调用 HAL_TIM_PWM_MspInit()：
       使能 TIM4 / GPIOB 时钟，并把 PB8 / PB9 配成复用推挽输出 */
    if (HAL_TIM_PWM_Init(&舵机_定时器) != HAL_OK) {
        Error_Handler();
    }

    输出比较.OCMode     = TIM_OCMODE_PWM1;
    输出比较.Pulse      = 0U;                       /* 先给 0，别让上电瞬间乱甩 */
    输出比较.OCPolarity = TIM_OCPOLARITY_HIGH;
    输出比较.OCFastMode = TIM_OCFAST_DISABLE;

    if (HAL_TIM_PWM_ConfigChannel(&舵机_定时器, &输出比较, 舵机_水平_通道) != HAL_OK) {
        Error_Handler();
    }
    if (HAL_TIM_PWM_ConfigChannel(&舵机_定时器, &输出比较, 舵机_垂直_通道) != HAL_OK) {
        Error_Handler();
    }

    if (HAL_TIM_PWM_Start(&舵机_定时器, 舵机_水平_通道) != HAL_OK) {
        Error_Handler();
    }
    if (HAL_TIM_PWM_Start(&舵机_定时器, 舵机_垂直_通道) != HAL_OK) {
        Error_Handler();
    }

    /* 上电就给一个确定的位置：不给的话舵机没收到信号会软掉，云台自己乱晃。
       这一步"立即到位"（不慢转）：开机就慢慢扫一遍反而让人以为云台没接好，
       而且要等 1.5 秒才稳住，任务启动时容易踩到还没到位的坑。 */
    舵机_设置角度立即(舵机_水平, 舵机_水平_中位角度);
    舵机_设置角度立即(舵机_垂直, 舵机_垂直_中位角度);

    /* ---- 打开"慢慢转"的节拍源：TIM4 更新中断，每 20 ms 一次 ---- */
    舵机_设置速度(舵机_默认速度);

    __HAL_TIM_CLEAR_IT(&舵机_定时器, TIM_IT_UPDATE);      /* 清掉计数过程中攒下的旧标志 */
    HAL_NVIC_SetPriority(舵机_中断号, 舵机_中断优先级, 0U);
    HAL_NVIC_EnableIRQ(舵机_中断号);
    __HAL_TIM_ENABLE_IT(&舵机_定时器, TIM_IT_UPDATE);
}

/**
  * @brief  TIM4 更新中断：每个 PWM 周期末尾进来一次，让舵机往前走一小步
  * @note   写在 servo.c 里（而不是 stm32f1xx_it.c）：本功能完全属于舵机驱动，
  *         放一起便于"整套拿走/整套删掉"。向量表里它是弱定义，这里直接覆盖。
  */
void TIM4_IRQHandler(void)
{
    if ((__HAL_TIM_GET_FLAG(&舵机_定时器, TIM_FLAG_UPDATE) != RESET) &&
        (__HAL_TIM_GET_IT_SOURCE(&舵机_定时器, TIM_IT_UPDATE) != RESET))
    {
        __HAL_TIM_CLEAR_IT(&舵机_定时器, TIM_IT_UPDATE);

        舵机_走一小步();
    }
}

void 舵机_设置脉宽(舵机_编号 哪台, uint16_t 微秒)
{
    if ((uint32_t)哪台 >= 舵机_数量) {
        return;
    }

    if (微秒 < 舵机_最小脉宽) { 微秒 = 舵机_最小脉宽; }
    if (微秒 > 舵机_最大脉宽) { 微秒 = 舵机_最大脉宽; }

    /* 先定目标再改当前位置：中途就算被 20 ms 中断插进来，
       它也只是朝同一个目标挪一步，不会走反方向 */
    舵机_目标_脉冲_Q4[哪台] = (uint32_t)微秒 * 16U;
    舵机_当_脉冲_Q4[哪台]   = (uint32_t)微秒 * 16U;

    舵机_输出(哪台);

    /* 立即生效，所以目标 = 实际 */
    舵机_角度[哪台] = 舵机_实际角度[哪台];
}

void 舵机_设置角度(舵机_编号 哪台, int16_t 角度)
{
    uint16_t 微秒;

    if ((uint32_t)哪台 >= 舵机_数量) {
        return;
    }

    微秒 = 舵机_换算脉宽(哪台, &角度);

    /* 只记下"要去哪儿"就返回，剩下的交给 20 ms 中断慢慢挪 */
    舵机_角度[哪台]         = 角度;
    舵机_目标_脉冲_Q4[哪台] = (uint32_t)微秒 * 16U;
}

void 舵机_设置角度立即(舵机_编号 哪台, int16_t 角度)
{
    uint16_t 微秒;

    if ((uint32_t)哪台 >= 舵机_数量) {
        return;
    }

    微秒 = 舵机_换算脉宽(哪台, &角度);

    舵机_设置脉宽(哪台, 微秒);       /* 顺带把目标也置成同一个值 */

    /* 脉宽存的是整微秒，反算回来可能差半度（比如 94° -> 1544 µs -> 93°）。
       这里是"一步到位"，指令角度就用调用方给的，别让它自己飘一格 */
    舵机_角度[哪台] = 角度;
}

void 舵机_全部中位(void)
{
    舵机_设置角度(舵机_水平, 舵机_水平_中位角度);
    舵机_设置角度(舵机_垂直, 舵机_垂直_中位角度);
}

void 舵机_设置速度(int16_t 度每秒)
{
    uint32_t 步;

    if (度每秒 < 舵机_最小速度) { 度每秒 = 舵机_最小速度; }
    if (度每秒 > 舵机_最大速度) { 度每秒 = 舵机_最大速度; }

    /* 每拍 20 ms = 每秒 50 拍
         度/秒 -> 每拍多少度  : 速度 / 50
         每拍多少度 -> 每拍多少 µs : × (舵机_最大脉宽 - 舵机_最小脉宽) / 舵机_角度上限
         再 × 16 换成 Q4 定标 */
    步 = ((uint32_t)度每秒 * (舵机_最大脉宽 - 舵机_最小脉宽) * 16U)
       / ((uint32_t)舵机_角度上限 * 50U);

    if (步 == 0U) {
        步 = 1U;                          /* 1/16 µs 是能表达的最小一步 */
    }

    舵机_每拍步进_Q4 = 步;
    舵机_当前速度    = 度每秒;
}

int16_t 舵机_读取速度(void)
{
    return 舵机_当前速度;
}
