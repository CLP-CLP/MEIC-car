/**
 ******************************************************************************
 * @file    main.c
 * @brief   STM32F103C8T6 (Blue Pill) 主程序
 *
 *  这里只有「初始化清单 + 主循环」，其余全部封装在独立模块中：
 *      板级        board.c / board.h             系统时钟 72 MHz、板载 LED
 *      巡线传感器  ir_sensor.c / ir_sensor.h     五路模拟红外传感器 PA0~PA4
 *      巡线控制    line_follow.c / line_follow.h  巡线逻辑
 *      电机        motor.c / motor.h             L298N 双电机（PB0/1/10/11 + PA6/7 PWM）
 *      串口        vcp.c / vcp.h                 USB 虚拟串口，printf 直接可用
 *      底层        retarget.c                    printf 重定向 + malloc 堆
 *                  stm32f1xx_hal_msp.c / stm32f1xx_hal_conf.h  外设时钟 / 引脚 / 模块裁剪
 *                  usbd_conf.c / usbd_conf.h       USB 底层对接
 *                  stm32f1xx_it.c                  中断服务程序
 *      任务        src/tasks/                  各竞赛任务（已从本文件拆出）
 ******************************************************************************
 */

/* Includes ------------------------------------------------------------------*/
#include "main.h"
#include "board.h"
#include "button.h"                /* 按键_初始化() */
#include "gray_calib.h"
#include "ir_sensor.h"
#include "menu.h"                   /* OLED 菜单 + 按键选择 */
#include "motor.h"
#include "oled.h"                   /* 提前点亮 OLED，校准期间也亮着 */
#include "proto.h"
#include "servo.h"                  /* 二维云台舵机（PB8/PB9） */
#include "tasks.h"                  /* 各任务函数声明（已拆分到 src/tasks/） */
#include "vcp.h"

#include <stdio.h>          /* 需要 printf 时直接可用 */

/* ========================== 上电工作方式（开关） ============================ */
/*  1 = 串口标定模式：上电就一直把 5 路传感器读数打到 USB 串口（OLED 也同步显示），
 *      完全不碰按键 —— 标定黑白阈值、或按键还没修好时，用这个；
 *  0 = OLED 菜单模式：用按键（PB12）短按选择 / 长按 2 秒确认运行任务。
 *
 *  标定完之后把下面的 1 改成 0 即可回到菜单。 */
#define 测试功能     0

/* ================================ 主函数 =================================== */
int main(void)
{
    /* ------------------------------ 初始化 -------------------------------- */
    HAL_Init();                     /* HAL 库初始化 + 1 ms 时基（SysTick） */
    板级_初始化();                  /* 系统时钟 72 MHz + 板载 LED (PC13) */

    显示_初始化();                  /* 提前点亮 OLED，避免校准扫描期间黑屏 */
    显示_清屏();
    显示_画字符串(0, 0, "BOOTING...");
    显示_刷新();

    巡线_初始化();                  /* 五路红外巡线传感器 (PA0~PA4) */
    电机_初始化();                  /* L298N 双电机（上电保持停止） */
    舵机_初始化();                  /* 二维云台两路舵机 PB8/PB9，上电到中位 */

    灰度_上电检查();                /* 读 Flash、上电次数 +1
                                       （这一步要擦写 Flash，CPU 会停顿约 40 ms，
                                        所以必须排在 USB 初始化之前，免得打断枚举） */

    虚拟串口_初始化();              /* USB 虚拟串口：放在最后，保证枚举不被打断 */

    灰度_就绪后处理();              /* 串口就绪：打印阈值/次数，需要时开始扫线校准 */

    协议_初始化();                  /* OpenMV 串口协议接收端（USART1 = PA9/PA10） */

    /* ------------------------------ 主循环 -------------------------------- */

    /* OpenMV 的识别结果不从这里读，在你的动作函数里直接调：
           协议_取卡面()          1/3/5/7，0 = 没有卡片
           协议_取库位()          'A'~'D'，0 = 没有卡片
           协议_等待卡片(毫秒,&卡片)  阻塞等一张卡，跑车时用它
           基础任务三：识别车前罗马数字，停在对应的 A/B/C/D 点 */

#if 测试功能

    {

        while(1)
        {
            电机_设置双轮(0, 0);
            舵机_设置角度(舵机_水平, 35);
            舵机_设置角度(舵机_垂直, 10);
            HAL_Delay(1000);
            舵机_设置角度(舵机_水平, 120);
            舵机_设置角度(舵机_垂直,70);
            HAL_Delay(1000);
        }
    }


    /* ---- 串口标定模式：一直往 USB 串口打 5 路 raw 值（永不返回）---- */
    菜单_串口标定();
#else
    /* ===== 主屏幕优先 =====
       上电先进主屏幕仪表板（五路传感器 + 电机转速 + 任务信息），
       按任意键进入菜单，选完任务自动退回主屏幕并执行。 */
    {
        菜单_任务执行器 任务;

        按键_初始化();

        for (;;) {
            显示_主屏幕();                 /* 仪表板循环，按任意键退出 */

            任务 = 菜单树_取待执行任务();
            if (任务 != NULL) {
                菜单树_清待执行任务();
                主屏幕_画一帧();           /* 运行前刷一帧"运行中" */
                任务();                    /* 真正的阻塞执行 */
                主屏幕_画一帧();           /* 运行后刷一帧"已完成" */
                HAL_Delay(1500U);          /* 短暂展示，等用户按键 */
            } else {
                菜单_运行();               /* 无待执行任务 → 进菜单 */
            }
        }
    }
#endif
}